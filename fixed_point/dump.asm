

; Generated by calling c:\Program Files (x86)\Arduino\hardware\tools\avr\bin>avr-objdump -S 
; "C:\\Users\\navon\\AppData\\Local\\Temp\\arduino_build_819193\\fixed_point.ino.elf" > dump.asm
; by Navonil Mukherjee

C:\\Users\\navon\\AppData\\Local\\Temp\\arduino_build_819193\\fixed_point.ino.elf:     file format elf32-avr


Disassembly of section .text:

00000000 <__vectors>:
       0:	0c 94 35 00 	jmp	0x6a	; 0x6a <__ctors_end>
       4:	0c 94 5d 00 	jmp	0xba	; 0xba <__bad_interrupt>
       8:	0c 94 5d 00 	jmp	0xba	; 0xba <__bad_interrupt>
       c:	0c 94 5d 00 	jmp	0xba	; 0xba <__bad_interrupt>
      10:	0c 94 5d 00 	jmp	0xba	; 0xba <__bad_interrupt>
      14:	0c 94 5d 00 	jmp	0xba	; 0xba <__bad_interrupt>
      18:	0c 94 5d 00 	jmp	0xba	; 0xba <__bad_interrupt>
      1c:	0c 94 5d 00 	jmp	0xba	; 0xba <__bad_interrupt>
      20:	0c 94 5d 00 	jmp	0xba	; 0xba <__bad_interrupt>
      24:	0c 94 5d 00 	jmp	0xba	; 0xba <__bad_interrupt>
      28:	0c 94 5d 00 	jmp	0xba	; 0xba <__bad_interrupt>
      2c:	0c 94 5d 00 	jmp	0xba	; 0xba <__bad_interrupt>
      30:	0c 94 5d 00 	jmp	0xba	; 0xba <__bad_interrupt>
      34:	0c 94 5d 00 	jmp	0xba	; 0xba <__bad_interrupt>
      38:	0c 94 5d 00 	jmp	0xba	; 0xba <__bad_interrupt>
      3c:	0c 94 5d 00 	jmp	0xba	; 0xba <__bad_interrupt>
      40:	0c 94 ed 02 	jmp	0x5da	; 0x5da <__vector_16>
      44:	0c 94 5d 00 	jmp	0xba	; 0xba <__bad_interrupt>
      48:	0c 94 bb 02 	jmp	0x576	; 0x576 <__vector_18>
      4c:	0c 94 95 02 	jmp	0x52a	; 0x52a <__vector_19>
      50:	0c 94 5d 00 	jmp	0xba	; 0xba <__bad_interrupt>
      54:	0c 94 5d 00 	jmp	0xba	; 0xba <__bad_interrupt>
      58:	0c 94 5d 00 	jmp	0xba	; 0xba <__bad_interrupt>
      5c:	0c 94 5d 00 	jmp	0xba	; 0xba <__bad_interrupt>
      60:	0c 94 5d 00 	jmp	0xba	; 0xba <__bad_interrupt>
      64:	0c 94 5d 00 	jmp	0xba	; 0xba <__bad_interrupt>

00000068 <__ctors_start>:
      68:	5b 05       	cpc	r21, r11

0000006a <__ctors_end>:
      6a:	11 24       	eor	r1, r1
      6c:	1f be       	out	0x3f, r1	; 63
      6e:	cf ef       	ldi	r28, 0xFF	; 255
      70:	d8 e0       	ldi	r29, 0x08	; 8
      72:	de bf       	out	0x3e, r29	; 62
      74:	cd bf       	out	0x3d, r28	; 61

00000076 <__do_copy_data>:
      76:	12 e0       	ldi	r17, 0x02	; 2
      78:	a0 e0       	ldi	r26, 0x00	; 0
      7a:	b1 e0       	ldi	r27, 0x01	; 1
      7c:	e4 eb       	ldi	r30, 0xB4	; 180
      7e:	f1 e1       	ldi	r31, 0x11	; 17
      80:	02 c0       	rjmp	.+4      	; 0x86 <__do_copy_data+0x10>
      82:	05 90       	lpm	r0, Z+
      84:	0d 92       	st	X+, r0
      86:	a4 33       	cpi	r26, 0x34	; 52
      88:	b1 07       	cpc	r27, r17
      8a:	d9 f7       	brne	.-10     	; 0x82 <__do_copy_data+0xc>

0000008c <__do_clear_bss>:
      8c:	22 e0       	ldi	r18, 0x02	; 2
      8e:	a4 e3       	ldi	r26, 0x34	; 52
      90:	b2 e0       	ldi	r27, 0x02	; 2
      92:	01 c0       	rjmp	.+2      	; 0x96 <.do_clear_bss_start>

00000094 <.do_clear_bss_loop>:
      94:	1d 92       	st	X+, r1

00000096 <.do_clear_bss_start>:
      96:	a8 3f       	cpi	r26, 0xF8	; 248
      98:	b2 07       	cpc	r27, r18
      9a:	e1 f7       	brne	.-8      	; 0x94 <.do_clear_bss_loop>

0000009c <__do_global_ctors>:
      9c:	10 e0       	ldi	r17, 0x00	; 0
      9e:	c5 e3       	ldi	r28, 0x35	; 53
      a0:	d0 e0       	ldi	r29, 0x00	; 0
      a2:	04 c0       	rjmp	.+8      	; 0xac <__do_global_ctors+0x10>
      a4:	21 97       	sbiw	r28, 0x01	; 1
      a6:	fe 01       	movw	r30, r28
      a8:	0e 94 d2 08 	call	0x11a4	; 0x11a4 <__tablejump2__>
      ac:	c4 33       	cpi	r28, 0x34	; 52
      ae:	d1 07       	cpc	r29, r17
      b0:	c9 f7       	brne	.-14     	; 0xa4 <__do_global_ctors+0x8>
      b2:	0e 94 37 03 	call	0x66e	; 0x66e <main>
      b6:	0c 94 d8 08 	jmp	0x11b0	; 0x11b0 <_exit>

000000ba <__bad_interrupt>:
      ba:	0c 94 00 00 	jmp	0	; 0x0 <__vectors>

000000be <_ZN5Print5writeEPKhj>:

// Public Methods //////////////////////////////////////////////////////////////

/* default implementation: may be overridden */
size_t Print::write(const uint8_t *buffer, size_t size)
{
      be:	af 92       	push	r10
      c0:	bf 92       	push	r11
      c2:	cf 92       	push	r12
      c4:	df 92       	push	r13
      c6:	ef 92       	push	r14
      c8:	ff 92       	push	r15
      ca:	0f 93       	push	r16
      cc:	1f 93       	push	r17
      ce:	cf 93       	push	r28
      d0:	df 93       	push	r29
      d2:	6c 01       	movw	r12, r24
      d4:	7b 01       	movw	r14, r22
      d6:	8b 01       	movw	r16, r22
      d8:	04 0f       	add	r16, r20
      da:	15 1f       	adc	r17, r21
      dc:	eb 01       	movw	r28, r22
      de:	5e 01       	movw	r10, r28
      e0:	ae 18       	sub	r10, r14
      e2:	bf 08       	sbc	r11, r15
  size_t n = 0;
  while (size--) {
      e4:	c0 17       	cp	r28, r16
      e6:	d1 07       	cpc	r29, r17
      e8:	59 f0       	breq	.+22     	; 0x100 <_ZN5Print5writeEPKhj+0x42>
    if (write(*buffer++)) n++;
      ea:	69 91       	ld	r22, Y+
      ec:	d6 01       	movw	r26, r12
      ee:	ed 91       	ld	r30, X+
      f0:	fc 91       	ld	r31, X
      f2:	01 90       	ld	r0, Z+
      f4:	f0 81       	ld	r31, Z
      f6:	e0 2d       	mov	r30, r0
      f8:	c6 01       	movw	r24, r12
      fa:	09 95       	icall
      fc:	89 2b       	or	r24, r25
      fe:	79 f7       	brne	.-34     	; 0xde <_ZN5Print5writeEPKhj+0x20>
    else break;
  }
  return n;
}
     100:	c5 01       	movw	r24, r10
     102:	df 91       	pop	r29
     104:	cf 91       	pop	r28
     106:	1f 91       	pop	r17
     108:	0f 91       	pop	r16
     10a:	ff 90       	pop	r15
     10c:	ef 90       	pop	r14
     10e:	df 90       	pop	r13
     110:	cf 90       	pop	r12
     112:	bf 90       	pop	r11
     114:	af 90       	pop	r10
     116:	08 95       	ret

00000118 <_ZN14HardwareSerial17availableForWriteEv>:
{
  tx_buffer_index_t head;
  tx_buffer_index_t tail;

  TX_BUFFER_ATOMIC {
    head = _tx_buffer_head;
     118:	fc 01       	movw	r30, r24
     11a:	53 8d       	ldd	r21, Z+27	; 0x1b
    tail = _tx_buffer_tail;
     11c:	44 8d       	ldd	r20, Z+28	; 0x1c
     11e:	25 2f       	mov	r18, r21
     120:	30 e0       	ldi	r19, 0x00	; 0
     122:	84 2f       	mov	r24, r20
     124:	90 e0       	ldi	r25, 0x00	; 0
  }
  if (head >= tail) return SERIAL_TX_BUFFER_SIZE - 1 - head + tail;
     126:	82 1b       	sub	r24, r18
     128:	93 0b       	sbc	r25, r19
     12a:	54 17       	cp	r21, r20
     12c:	10 f0       	brcs	.+4      	; 0x132 <_ZN14HardwareSerial17availableForWriteEv+0x1a>
     12e:	cf 96       	adiw	r24, 0x3f	; 63
     130:	08 95       	ret
  return tail - head - 1;
     132:	01 97       	sbiw	r24, 0x01	; 1
}
     134:	08 95       	ret

00000136 <_ZN14HardwareSerial4readEv>:
    return _rx_buffer[_rx_buffer_tail];
  }
}

int HardwareSerial::read(void)
{
     136:	fc 01       	movw	r30, r24
  // if the head isn't ahead of the tail, we don't have any characters
  if (_rx_buffer_head == _rx_buffer_tail) {
     138:	91 8d       	ldd	r25, Z+25	; 0x19
     13a:	82 8d       	ldd	r24, Z+26	; 0x1a
     13c:	98 17       	cp	r25, r24
     13e:	61 f0       	breq	.+24     	; 0x158 <_ZN14HardwareSerial4readEv+0x22>
    return -1;
  } else {
    unsigned char c = _rx_buffer[_rx_buffer_tail];
     140:	a2 8d       	ldd	r26, Z+26	; 0x1a
     142:	ae 0f       	add	r26, r30
     144:	bf 2f       	mov	r27, r31
     146:	b1 1d       	adc	r27, r1
     148:	5d 96       	adiw	r26, 0x1d	; 29
     14a:	8c 91       	ld	r24, X
    _rx_buffer_tail = (rx_buffer_index_t)(_rx_buffer_tail + 1) % SERIAL_RX_BUFFER_SIZE;
     14c:	92 8d       	ldd	r25, Z+26	; 0x1a
     14e:	9f 5f       	subi	r25, 0xFF	; 255
     150:	9f 73       	andi	r25, 0x3F	; 63
     152:	92 8f       	std	Z+26, r25	; 0x1a
    return c;
     154:	90 e0       	ldi	r25, 0x00	; 0
     156:	08 95       	ret

int HardwareSerial::read(void)
{
  // if the head isn't ahead of the tail, we don't have any characters
  if (_rx_buffer_head == _rx_buffer_tail) {
    return -1;
     158:	8f ef       	ldi	r24, 0xFF	; 255
     15a:	9f ef       	ldi	r25, 0xFF	; 255
  } else {
    unsigned char c = _rx_buffer[_rx_buffer_tail];
    _rx_buffer_tail = (rx_buffer_index_t)(_rx_buffer_tail + 1) % SERIAL_RX_BUFFER_SIZE;
    return c;
  }
}
     15c:	08 95       	ret

0000015e <_ZN14HardwareSerial4peekEv>:
{
  return ((unsigned int)(SERIAL_RX_BUFFER_SIZE + _rx_buffer_head - _rx_buffer_tail)) % SERIAL_RX_BUFFER_SIZE;
}

int HardwareSerial::peek(void)
{
     15e:	fc 01       	movw	r30, r24
  if (_rx_buffer_head == _rx_buffer_tail) {
     160:	91 8d       	ldd	r25, Z+25	; 0x19
     162:	82 8d       	ldd	r24, Z+26	; 0x1a
     164:	98 17       	cp	r25, r24
     166:	31 f0       	breq	.+12     	; 0x174 <_ZN14HardwareSerial4peekEv+0x16>
    return -1;
  } else {
    return _rx_buffer[_rx_buffer_tail];
     168:	82 8d       	ldd	r24, Z+26	; 0x1a
     16a:	e8 0f       	add	r30, r24
     16c:	f1 1d       	adc	r31, r1
     16e:	85 8d       	ldd	r24, Z+29	; 0x1d
     170:	90 e0       	ldi	r25, 0x00	; 0
     172:	08 95       	ret
}

int HardwareSerial::peek(void)
{
  if (_rx_buffer_head == _rx_buffer_tail) {
    return -1;
     174:	8f ef       	ldi	r24, 0xFF	; 255
     176:	9f ef       	ldi	r25, 0xFF	; 255
  } else {
    return _rx_buffer[_rx_buffer_tail];
  }
}
     178:	08 95       	ret

0000017a <_ZN14HardwareSerial9availableEv>:
  // clear any received data
  _rx_buffer_head = _rx_buffer_tail;
}

int HardwareSerial::available(void)
{
     17a:	fc 01       	movw	r30, r24
  return ((unsigned int)(SERIAL_RX_BUFFER_SIZE + _rx_buffer_head - _rx_buffer_tail)) % SERIAL_RX_BUFFER_SIZE;
     17c:	91 8d       	ldd	r25, Z+25	; 0x19
     17e:	22 8d       	ldd	r18, Z+26	; 0x1a
     180:	89 2f       	mov	r24, r25
     182:	90 e0       	ldi	r25, 0x00	; 0
     184:	80 5c       	subi	r24, 0xC0	; 192
     186:	9f 4f       	sbci	r25, 0xFF	; 255
     188:	82 1b       	sub	r24, r18
     18a:	91 09       	sbc	r25, r1
}
     18c:	8f 73       	andi	r24, 0x3F	; 63
     18e:	99 27       	eor	r25, r25
     190:	08 95       	ret

00000192 <_Z17Serial0_availablev>:
#endif

// Function that can be weakly referenced by serialEventRun to prevent
// pulling in this file if it's not otherwise used.
bool Serial0_available() {
  return Serial.available();
     192:	8b e5       	ldi	r24, 0x5B	; 91
     194:	92 e0       	ldi	r25, 0x02	; 2
     196:	0e 94 bd 00 	call	0x17a	; 0x17a <_ZN14HardwareSerial9availableEv>
     19a:	21 e0       	ldi	r18, 0x01	; 1
     19c:	89 2b       	or	r24, r25
     19e:	09 f4       	brne	.+2      	; 0x1a2 <_Z17Serial0_availablev+0x10>
     1a0:	20 e0       	ldi	r18, 0x00	; 0
}
     1a2:	82 2f       	mov	r24, r18
     1a4:	08 95       	ret

000001a6 <_Z14serialEventRunv>:
#endif

void serialEventRun(void)
{
#if defined(HAVE_HWSERIAL0)
  if (Serial0_available && serialEvent && Serial0_available()) serialEvent();
     1a6:	80 e0       	ldi	r24, 0x00	; 0
     1a8:	90 e0       	ldi	r25, 0x00	; 0
     1aa:	89 2b       	or	r24, r25
     1ac:	29 f0       	breq	.+10     	; 0x1b8 <_Z14serialEventRunv+0x12>
     1ae:	0e 94 c9 00 	call	0x192	; 0x192 <_Z17Serial0_availablev>
     1b2:	81 11       	cpse	r24, r1
     1b4:	0c 94 00 00 	jmp	0	; 0x0 <__vectors>
  if (Serial2_available && serialEvent2 && Serial2_available()) serialEvent2();
#endif
#if defined(HAVE_HWSERIAL3)
  if (Serial3_available && serialEvent3 && Serial3_available()) serialEvent3();
#endif
}
     1b8:	08 95       	ret

000001ba <_ZN14HardwareSerial17_tx_udr_empty_irqEv>:
#endif

// Actual interrupt handlers //////////////////////////////////////////////////////////////

void HardwareSerial::_tx_udr_empty_irq(void)
{
     1ba:	fc 01       	movw	r30, r24
  // If interrupts are enabled, there must be more data in the output
  // buffer. Send the next byte
  unsigned char c = _tx_buffer[_tx_buffer_tail];
     1bc:	a4 8d       	ldd	r26, Z+28	; 0x1c
     1be:	a8 0f       	add	r26, r24
     1c0:	b9 2f       	mov	r27, r25
     1c2:	b1 1d       	adc	r27, r1
     1c4:	a3 5a       	subi	r26, 0xA3	; 163
     1c6:	bf 4f       	sbci	r27, 0xFF	; 255
     1c8:	2c 91       	ld	r18, X
  _tx_buffer_tail = (_tx_buffer_tail + 1) % SERIAL_TX_BUFFER_SIZE;
     1ca:	84 8d       	ldd	r24, Z+28	; 0x1c
     1cc:	90 e0       	ldi	r25, 0x00	; 0
     1ce:	01 96       	adiw	r24, 0x01	; 1
     1d0:	8f 73       	andi	r24, 0x3F	; 63
     1d2:	99 27       	eor	r25, r25
     1d4:	84 8f       	std	Z+28, r24	; 0x1c

  *_udr = c;
     1d6:	a6 89       	ldd	r26, Z+22	; 0x16
     1d8:	b7 89       	ldd	r27, Z+23	; 0x17
     1da:	2c 93       	st	X, r18
  // location". This makes sure flush() won't return until the bytes
  // actually got written. Other r/w bits are preserved, and zeroes
  // written to the rest.

#ifdef MPCM0
  *_ucsra = ((*_ucsra) & ((1 << U2X0) | (1 << MPCM0))) | (1 << TXC0);
     1dc:	a0 89       	ldd	r26, Z+16	; 0x10
     1de:	b1 89       	ldd	r27, Z+17	; 0x11
     1e0:	8c 91       	ld	r24, X
     1e2:	83 70       	andi	r24, 0x03	; 3
     1e4:	80 64       	ori	r24, 0x40	; 64
     1e6:	8c 93       	st	X, r24
#else
  *_ucsra = ((*_ucsra) & ((1 << U2X0) | (1 << TXC0)));
#endif

  if (_tx_buffer_head == _tx_buffer_tail) {
     1e8:	93 8d       	ldd	r25, Z+27	; 0x1b
     1ea:	84 8d       	ldd	r24, Z+28	; 0x1c
     1ec:	98 13       	cpse	r25, r24
     1ee:	06 c0       	rjmp	.+12     	; 0x1fc <_ZN14HardwareSerial17_tx_udr_empty_irqEv+0x42>
    // Buffer empty, so disable interrupts
    cbi(*_ucsrb, UDRIE0);
     1f0:	02 88       	ldd	r0, Z+18	; 0x12
     1f2:	f3 89       	ldd	r31, Z+19	; 0x13
     1f4:	e0 2d       	mov	r30, r0
     1f6:	80 81       	ld	r24, Z
     1f8:	8f 7d       	andi	r24, 0xDF	; 223
     1fa:	80 83       	st	Z, r24
  }
}
     1fc:	08 95       	ret

000001fe <_ZN14HardwareSerial5writeEh>:
  // If we get here, nothing is queued anymore (DRIE is disabled) and
  // the hardware finished tranmission (TXC is set).
}

size_t HardwareSerial::write(uint8_t c)
{
     1fe:	ef 92       	push	r14
     200:	ff 92       	push	r15
     202:	0f 93       	push	r16
     204:	1f 93       	push	r17
     206:	cf 93       	push	r28
     208:	df 93       	push	r29
     20a:	ec 01       	movw	r28, r24
  _written = true;
     20c:	81 e0       	ldi	r24, 0x01	; 1
     20e:	88 8f       	std	Y+24, r24	; 0x18
  // If the buffer and the data register is empty, just write the byte
  // to the data register and be done. This shortcut helps
  // significantly improve the effective datarate at high (>
  // 500kbit/s) bitrates, where interrupt overhead becomes a slowdown.
  if (_tx_buffer_head == _tx_buffer_tail && bit_is_set(*_ucsra, UDRE0)) {
     210:	9b 8d       	ldd	r25, Y+27	; 0x1b
     212:	8c 8d       	ldd	r24, Y+28	; 0x1c
     214:	98 13       	cpse	r25, r24
     216:	1a c0       	rjmp	.+52     	; 0x24c <_ZN14HardwareSerial5writeEh+0x4e>
     218:	e8 89       	ldd	r30, Y+16	; 0x10
     21a:	f9 89       	ldd	r31, Y+17	; 0x11
     21c:	80 81       	ld	r24, Z
     21e:	85 ff       	sbrs	r24, 5
     220:	15 c0       	rjmp	.+42     	; 0x24c <_ZN14HardwareSerial5writeEh+0x4e>
    // So writing UDR must happen first.
    // Writing UDR and clearing TC must be done atomically, otherwise
    // interrupts might delay the TXC clear so the byte written to UDR
    // is transmitted (setting TXC) before clearing TXC. Then TXC will
    // be cleared when no bytes are left, causing flush() to hang
    ATOMIC_BLOCK(ATOMIC_RESTORESTATE) {
     222:	9f b7       	in	r25, 0x3f	; 63
    return 1;
}

static __inline__ uint8_t __iCliRetVal(void)
{
    cli();
     224:	f8 94       	cli
      *_udr = c;
     226:	ee 89       	ldd	r30, Y+22	; 0x16
     228:	ff 89       	ldd	r31, Y+23	; 0x17
     22a:	60 83       	st	Z, r22
#ifdef MPCM0
      *_ucsra = ((*_ucsra) & ((1 << U2X0) | (1 << MPCM0))) | (1 << TXC0);
     22c:	e8 89       	ldd	r30, Y+16	; 0x10
     22e:	f9 89       	ldd	r31, Y+17	; 0x11
     230:	80 81       	ld	r24, Z
     232:	83 70       	andi	r24, 0x03	; 3
     234:	80 64       	ori	r24, 0x40	; 64
  // make atomic to prevent execution of ISR between setting the
  // head pointer and setting the interrupt flag resulting in buffer
  // retransmission
  ATOMIC_BLOCK(ATOMIC_RESTORESTATE) {
    _tx_buffer_head = i;
    sbi(*_ucsrb, UDRIE0);
     236:	80 83       	st	Z, r24
    (void)__s;
}

static __inline__ void __iRestore(const  uint8_t *__s)
{
    SREG = *__s;
     238:	9f bf       	out	0x3f, r25	; 63
  }
  
  return 1;
}
     23a:	81 e0       	ldi	r24, 0x01	; 1
     23c:	90 e0       	ldi	r25, 0x00	; 0
     23e:	df 91       	pop	r29
     240:	cf 91       	pop	r28
     242:	1f 91       	pop	r17
     244:	0f 91       	pop	r16
     246:	ff 90       	pop	r15
     248:	ef 90       	pop	r14
     24a:	08 95       	ret
     24c:	f6 2e       	mov	r15, r22
      *_ucsra = ((*_ucsra) & ((1 << U2X0) | (1 << TXC0)));
#endif
    }
    return 1;
  }
  tx_buffer_index_t i = (_tx_buffer_head + 1) % SERIAL_TX_BUFFER_SIZE;
     24e:	0b 8d       	ldd	r16, Y+27	; 0x1b
     250:	10 e0       	ldi	r17, 0x00	; 0
     252:	0f 5f       	subi	r16, 0xFF	; 255
     254:	1f 4f       	sbci	r17, 0xFF	; 255
     256:	0f 73       	andi	r16, 0x3F	; 63
     258:	11 27       	eor	r17, r17
     25a:	e0 2e       	mov	r14, r16
	
  // If the output buffer is full, there's nothing for it other than to 
  // wait for the interrupt handler to empty it a bit
  while (i == _tx_buffer_tail) {
     25c:	8c 8d       	ldd	r24, Y+28	; 0x1c
     25e:	8e 11       	cpse	r24, r14
     260:	0c c0       	rjmp	.+24     	; 0x27a <_ZN14HardwareSerial5writeEh+0x7c>
    if (bit_is_clear(SREG, SREG_I)) {
     262:	0f b6       	in	r0, 0x3f	; 63
     264:	07 fc       	sbrc	r0, 7
     266:	fa cf       	rjmp	.-12     	; 0x25c <_ZN14HardwareSerial5writeEh+0x5e>
      // Interrupts are disabled, so we'll have to poll the data
      // register empty flag ourselves. If it is set, pretend an
      // interrupt has happened and call the handler to free up
      // space for us.
      if(bit_is_set(*_ucsra, UDRE0))
     268:	e8 89       	ldd	r30, Y+16	; 0x10
     26a:	f9 89       	ldd	r31, Y+17	; 0x11
     26c:	80 81       	ld	r24, Z
     26e:	85 ff       	sbrs	r24, 5
     270:	f5 cf       	rjmp	.-22     	; 0x25c <_ZN14HardwareSerial5writeEh+0x5e>
	_tx_udr_empty_irq();
     272:	ce 01       	movw	r24, r28
     274:	0e 94 dd 00 	call	0x1ba	; 0x1ba <_ZN14HardwareSerial17_tx_udr_empty_irqEv>
     278:	f1 cf       	rjmp	.-30     	; 0x25c <_ZN14HardwareSerial5writeEh+0x5e>
    } else {
      // nop, the interrupt handler will free up space for us
    }
  }

  _tx_buffer[_tx_buffer_head] = c;
     27a:	eb 8d       	ldd	r30, Y+27	; 0x1b
     27c:	ec 0f       	add	r30, r28
     27e:	fd 2f       	mov	r31, r29
     280:	f1 1d       	adc	r31, r1
     282:	e3 5a       	subi	r30, 0xA3	; 163
     284:	ff 4f       	sbci	r31, 0xFF	; 255
     286:	f0 82       	st	Z, r15

  // make atomic to prevent execution of ISR between setting the
  // head pointer and setting the interrupt flag resulting in buffer
  // retransmission
  ATOMIC_BLOCK(ATOMIC_RESTORESTATE) {
     288:	9f b7       	in	r25, 0x3f	; 63
    return 1;
}

static __inline__ uint8_t __iCliRetVal(void)
{
    cli();
     28a:	f8 94       	cli
    _tx_buffer_head = i;
     28c:	0b 8f       	std	Y+27, r16	; 0x1b
    sbi(*_ucsrb, UDRIE0);
     28e:	ea 89       	ldd	r30, Y+18	; 0x12
     290:	fb 89       	ldd	r31, Y+19	; 0x13
     292:	80 81       	ld	r24, Z
     294:	80 62       	ori	r24, 0x20	; 32
     296:	cf cf       	rjmp	.-98     	; 0x236 <_ZN14HardwareSerial5writeEh+0x38>

00000298 <_ZN14HardwareSerial5flushEv>:
  if (head >= tail) return SERIAL_TX_BUFFER_SIZE - 1 - head + tail;
  return tail - head - 1;
}

void HardwareSerial::flush()
{
     298:	cf 93       	push	r28
     29a:	df 93       	push	r29
     29c:	ec 01       	movw	r28, r24
  // If we have never written a byte, no need to flush. This special
  // case is needed since there is no way to force the TXC (transmit
  // complete) bit to 1 during initialization
  if (!_written)
     29e:	88 8d       	ldd	r24, Y+24	; 0x18
     2a0:	88 23       	and	r24, r24
     2a2:	b9 f0       	breq	.+46     	; 0x2d2 <_ZN14HardwareSerial5flushEv+0x3a>
    return;

  while (bit_is_set(*_ucsrb, UDRIE0) || bit_is_clear(*_ucsra, TXC0)) {
     2a4:	aa 89       	ldd	r26, Y+18	; 0x12
     2a6:	bb 89       	ldd	r27, Y+19	; 0x13
     2a8:	e8 89       	ldd	r30, Y+16	; 0x10
     2aa:	f9 89       	ldd	r31, Y+17	; 0x11
     2ac:	8c 91       	ld	r24, X
     2ae:	85 fd       	sbrc	r24, 5
     2b0:	03 c0       	rjmp	.+6      	; 0x2b8 <_ZN14HardwareSerial5flushEv+0x20>
     2b2:	80 81       	ld	r24, Z
     2b4:	86 fd       	sbrc	r24, 6
     2b6:	0d c0       	rjmp	.+26     	; 0x2d2 <_ZN14HardwareSerial5flushEv+0x3a>
    if (bit_is_clear(SREG, SREG_I) && bit_is_set(*_ucsrb, UDRIE0))
     2b8:	0f b6       	in	r0, 0x3f	; 63
     2ba:	07 fc       	sbrc	r0, 7
     2bc:	f7 cf       	rjmp	.-18     	; 0x2ac <_ZN14HardwareSerial5flushEv+0x14>
     2be:	8c 91       	ld	r24, X
     2c0:	85 ff       	sbrs	r24, 5
     2c2:	f2 cf       	rjmp	.-28     	; 0x2a8 <_ZN14HardwareSerial5flushEv+0x10>
	// Interrupts are globally disabled, but the DR empty
	// interrupt should be enabled, so poll the DR empty flag to
	// prevent deadlock
	if (bit_is_set(*_ucsra, UDRE0))
     2c4:	80 81       	ld	r24, Z
     2c6:	85 ff       	sbrs	r24, 5
     2c8:	ed cf       	rjmp	.-38     	; 0x2a4 <_ZN14HardwareSerial5flushEv+0xc>
	  _tx_udr_empty_irq();
     2ca:	ce 01       	movw	r24, r28
     2cc:	0e 94 dd 00 	call	0x1ba	; 0x1ba <_ZN14HardwareSerial17_tx_udr_empty_irqEv>
     2d0:	e9 cf       	rjmp	.-46     	; 0x2a4 <_ZN14HardwareSerial5flushEv+0xc>
  }
  // If we get here, nothing is queued anymore (DRIE is disabled) and
  // the hardware finished tranmission (TXC is set).
}
     2d2:	df 91       	pop	r29
     2d4:	cf 91       	pop	r28
     2d6:	08 95       	ret

000002d8 <_ZN5Print5writeEPKc.part.2.constprop.27>:
    void clearWriteError() { setWriteError(0); }
  
    virtual size_t write(uint8_t) = 0;
    size_t write(const char *str) {
      if (str == NULL) return 0;
      return write((const uint8_t *)str, strlen(str));
     2d8:	fc 01       	movw	r30, r24
     2da:	01 90       	ld	r0, Z+
     2dc:	00 20       	and	r0, r0
     2de:	e9 f7       	brne	.-6      	; 0x2da <_ZN5Print5writeEPKc.part.2.constprop.27+0x2>
     2e0:	31 97       	sbiw	r30, 0x01	; 1
     2e2:	af 01       	movw	r20, r30
     2e4:	48 1b       	sub	r20, r24
     2e6:	59 0b       	sbc	r21, r25
     2e8:	bc 01       	movw	r22, r24
     2ea:	8b e5       	ldi	r24, 0x5B	; 91
     2ec:	92 e0       	ldi	r25, 0x02	; 2
     2ee:	0c 94 5f 00 	jmp	0xbe	; 0xbe <_ZN5Print5writeEPKhj>

000002f2 <_ZN5Print11printNumberEmh.constprop.24>:
  return n;
}

// Private Methods /////////////////////////////////////////////////////////////

size_t Print::printNumber(unsigned long n, uint8_t base)
     2f2:	8f 92       	push	r8
     2f4:	9f 92       	push	r9
     2f6:	af 92       	push	r10
     2f8:	bf 92       	push	r11
     2fa:	0f 93       	push	r16
     2fc:	1f 93       	push	r17
     2fe:	cf 93       	push	r28
     300:	df 93       	push	r29
     302:	cd b7       	in	r28, 0x3d	; 61
     304:	de b7       	in	r29, 0x3e	; 62
     306:	a1 97       	sbiw	r28, 0x21	; 33
     308:	0f b6       	in	r0, 0x3f	; 63
     30a:	f8 94       	cli
     30c:	de bf       	out	0x3e, r29	; 62
     30e:	0f be       	out	0x3f, r0	; 63
     310:	cd bf       	out	0x3d, r28	; 61
{
  char buf[8 * sizeof(long) + 1]; // Assumes 8-bit chars plus zero byte.
  char *str = &buf[sizeof(buf) - 1];

  *str = '\0';
     312:	19 a2       	std	Y+33, r1	; 0x21

  // prevent crash if called with base == 1
  if (base < 2) base = 10;
     314:	42 30       	cpi	r20, 0x02	; 2
     316:	08 f4       	brcc	.+2      	; 0x31a <_ZN5Print11printNumberEmh.constprop.24+0x28>
     318:	4a e0       	ldi	r20, 0x0A	; 10
     31a:	8e 01       	movw	r16, r28
     31c:	0f 5d       	subi	r16, 0xDF	; 223
     31e:	1f 4f       	sbci	r17, 0xFF	; 255

  do {
    char c = n % base;
     320:	84 2e       	mov	r8, r20
     322:	91 2c       	mov	r9, r1
     324:	b1 2c       	mov	r11, r1
     326:	a1 2c       	mov	r10, r1
     328:	a5 01       	movw	r20, r10
     32a:	94 01       	movw	r18, r8
     32c:	0e 94 5e 06 	call	0xcbc	; 0xcbc <__udivmodsi4>
     330:	e6 2f       	mov	r30, r22
    n /= base;
     332:	b9 01       	movw	r22, r18
     334:	ca 01       	movw	r24, r20

    *--str = c < 10 ? c + '0' : c + 'A' - 10;
     336:	ea 30       	cpi	r30, 0x0A	; 10
     338:	f4 f4       	brge	.+60     	; 0x376 <_ZN5Print11printNumberEmh.constprop.24+0x84>
     33a:	e0 5d       	subi	r30, 0xD0	; 208
     33c:	d8 01       	movw	r26, r16
     33e:	ee 93       	st	-X, r30
     340:	8d 01       	movw	r16, r26
  } while(n);
     342:	23 2b       	or	r18, r19
     344:	24 2b       	or	r18, r20
     346:	25 2b       	or	r18, r21
     348:	79 f7       	brne	.-34     	; 0x328 <_ZN5Print11printNumberEmh.constprop.24+0x36>
    int getWriteError() { return write_error; }
    void clearWriteError() { setWriteError(0); }
  
    virtual size_t write(uint8_t) = 0;
    size_t write(const char *str) {
      if (str == NULL) return 0;
     34a:	90 e0       	ldi	r25, 0x00	; 0
     34c:	80 e0       	ldi	r24, 0x00	; 0
     34e:	10 97       	sbiw	r26, 0x00	; 0
     350:	19 f0       	breq	.+6      	; 0x358 <_ZN5Print11printNumberEmh.constprop.24+0x66>
     352:	cd 01       	movw	r24, r26
     354:	0e 94 6c 01 	call	0x2d8	; 0x2d8 <_ZN5Print5writeEPKc.part.2.constprop.27>

  return write(str);
}
     358:	a1 96       	adiw	r28, 0x21	; 33
     35a:	0f b6       	in	r0, 0x3f	; 63
     35c:	f8 94       	cli
     35e:	de bf       	out	0x3e, r29	; 62
     360:	0f be       	out	0x3f, r0	; 63
     362:	cd bf       	out	0x3d, r28	; 61
     364:	df 91       	pop	r29
     366:	cf 91       	pop	r28
     368:	1f 91       	pop	r17
     36a:	0f 91       	pop	r16
     36c:	bf 90       	pop	r11
     36e:	af 90       	pop	r10
     370:	9f 90       	pop	r9
     372:	8f 90       	pop	r8
     374:	08 95       	ret

  do {
    char c = n % base;
    n /= base;

    *--str = c < 10 ? c + '0' : c + 'A' - 10;
     376:	e9 5c       	subi	r30, 0xC9	; 201
     378:	e1 cf       	rjmp	.-62     	; 0x33c <_ZN5Print11printNumberEmh.constprop.24+0x4a>

0000037a <_ZN5Print7printlnEPKc.constprop.18>:
  size_t n = print(s);
  n += println();
  return n;
}

size_t Print::println(const char c[])
     37a:	cf 93       	push	r28
     37c:	df 93       	push	r29
     37e:	0e 94 6c 01 	call	0x2d8	; 0x2d8 <_ZN5Print5writeEPKc.part.2.constprop.27>
     382:	ec 01       	movw	r28, r24
     384:	8e e1       	ldi	r24, 0x1E	; 30
     386:	91 e0       	ldi	r25, 0x01	; 1
     388:	0e 94 6c 01 	call	0x2d8	; 0x2d8 <_ZN5Print5writeEPKc.part.2.constprop.27>
{
  size_t n = print(c);
  n += println();
  return n;
}
     38c:	8c 0f       	add	r24, r28
     38e:	9d 1f       	adc	r25, r29
     390:	df 91       	pop	r29
     392:	cf 91       	pop	r28
     394:	08 95       	ret

00000396 <_ZN5Print7printlnEdi.constprop.11>:
  size_t n = print(num, base);
  n += println();
  return n;
}

size_t Print::println(double num, int digits)
     396:	4f 92       	push	r4
     398:	5f 92       	push	r5
     39a:	6f 92       	push	r6
     39c:	7f 92       	push	r7
     39e:	8f 92       	push	r8
     3a0:	9f 92       	push	r9
     3a2:	af 92       	push	r10
     3a4:	bf 92       	push	r11
     3a6:	cf 92       	push	r12
     3a8:	df 92       	push	r13
     3aa:	ef 92       	push	r14
     3ac:	ff 92       	push	r15
     3ae:	6b 01       	movw	r12, r22
     3b0:	7c 01       	movw	r14, r24

size_t Print::printFloat(double number, uint8_t digits) 
{ 
  size_t n = 0;
  
  if (isnan(number)) return print("nan");
     3b2:	ac 01       	movw	r20, r24
     3b4:	9b 01       	movw	r18, r22
     3b6:	0e 94 cd 08 	call	0x119a	; 0x119a <__unordsf2>
     3ba:	88 23       	and	r24, r24
     3bc:	c1 f0       	breq	.+48     	; 0x3ee <_ZN5Print7printlnEdi.constprop.11+0x58>
     3be:	81 e2       	ldi	r24, 0x21	; 33
     3c0:	91 e0       	ldi	r25, 0x01	; 1
     3c2:	0e 94 6c 01 	call	0x2d8	; 0x2d8 <_ZN5Print5writeEPKc.part.2.constprop.27>
     3c6:	7c 01       	movw	r14, r24
     3c8:	8e e1       	ldi	r24, 0x1E	; 30
     3ca:	91 e0       	ldi	r25, 0x01	; 1
     3cc:	0e 94 6c 01 	call	0x2d8	; 0x2d8 <_ZN5Print5writeEPKc.part.2.constprop.27>
size_t Print::println(double num, int digits)
{
  size_t n = print(num, digits);
  n += println();
  return n;
}
     3d0:	8e 0d       	add	r24, r14
     3d2:	9f 1d       	adc	r25, r15
     3d4:	ff 90       	pop	r15
     3d6:	ef 90       	pop	r14
     3d8:	df 90       	pop	r13
     3da:	cf 90       	pop	r12
     3dc:	bf 90       	pop	r11
     3de:	af 90       	pop	r10
     3e0:	9f 90       	pop	r9
     3e2:	8f 90       	pop	r8
     3e4:	7f 90       	pop	r7
     3e6:	6f 90       	pop	r6
     3e8:	5f 90       	pop	r5
     3ea:	4f 90       	pop	r4
     3ec:	08 95       	ret
size_t Print::printFloat(double number, uint8_t digits) 
{ 
  size_t n = 0;
  
  if (isnan(number)) return print("nan");
  if (isinf(number)) return print("inf");
     3ee:	46 01       	movw	r8, r12
     3f0:	57 01       	movw	r10, r14
     3f2:	e8 94       	clt
     3f4:	b7 f8       	bld	r11, 7
     3f6:	2f ef       	ldi	r18, 0xFF	; 255
     3f8:	3f ef       	ldi	r19, 0xFF	; 255
     3fa:	4f e7       	ldi	r20, 0x7F	; 127
     3fc:	5f e7       	ldi	r21, 0x7F	; 127
     3fe:	c5 01       	movw	r24, r10
     400:	b4 01       	movw	r22, r8
     402:	0e 94 cd 08 	call	0x119a	; 0x119a <__unordsf2>
     406:	81 11       	cpse	r24, r1
     408:	0d c0       	rjmp	.+26     	; 0x424 <__LOCK_REGION_LENGTH__+0x24>
     40a:	2f ef       	ldi	r18, 0xFF	; 255
     40c:	3f ef       	ldi	r19, 0xFF	; 255
     40e:	4f e7       	ldi	r20, 0x7F	; 127
     410:	5f e7       	ldi	r21, 0x7F	; 127
     412:	c5 01       	movw	r24, r10
     414:	b4 01       	movw	r22, r8
     416:	0e 94 fc 06 	call	0xdf8	; 0xdf8 <__cmpsf2>
     41a:	18 16       	cp	r1, r24
     41c:	1c f4       	brge	.+6      	; 0x424 <__LOCK_REGION_LENGTH__+0x24>
     41e:	85 e2       	ldi	r24, 0x25	; 37
     420:	91 e0       	ldi	r25, 0x01	; 1
     422:	cf cf       	rjmp	.-98     	; 0x3c2 <_ZN5Print7printlnEdi.constprop.11+0x2c>
  if (number > 4294967040.0) return print ("ovf");  // constant determined empirically
     424:	2f ef       	ldi	r18, 0xFF	; 255
     426:	3f ef       	ldi	r19, 0xFF	; 255
     428:	4f e7       	ldi	r20, 0x7F	; 127
     42a:	5f e4       	ldi	r21, 0x4F	; 79
     42c:	c7 01       	movw	r24, r14
     42e:	b6 01       	movw	r22, r12
     430:	0e 94 5b 08 	call	0x10b6	; 0x10b6 <__gesf2>
     434:	18 16       	cp	r1, r24
     436:	1c f4       	brge	.+6      	; 0x43e <__LOCK_REGION_LENGTH__+0x3e>
     438:	89 e2       	ldi	r24, 0x29	; 41
     43a:	91 e0       	ldi	r25, 0x01	; 1
     43c:	c2 cf       	rjmp	.-124    	; 0x3c2 <_ZN5Print7printlnEdi.constprop.11+0x2c>
  if (number <-4294967040.0) return print ("ovf");  // constant determined empirically
     43e:	2f ef       	ldi	r18, 0xFF	; 255
     440:	3f ef       	ldi	r19, 0xFF	; 255
     442:	4f e7       	ldi	r20, 0x7F	; 127
     444:	5f ec       	ldi	r21, 0xCF	; 207
     446:	c7 01       	movw	r24, r14
     448:	b6 01       	movw	r22, r12
     44a:	0e 94 fc 06 	call	0xdf8	; 0xdf8 <__cmpsf2>
     44e:	87 fd       	sbrc	r24, 7
     450:	f3 cf       	rjmp	.-26     	; 0x438 <__LOCK_REGION_LENGTH__+0x38>
  
  // Handle negative numbers
  if (number < 0.0)
     452:	20 e0       	ldi	r18, 0x00	; 0
     454:	30 e0       	ldi	r19, 0x00	; 0
     456:	a9 01       	movw	r20, r18
     458:	c7 01       	movw	r24, r14
     45a:	b6 01       	movw	r22, r12
     45c:	0e 94 fc 06 	call	0xdf8	; 0xdf8 <__cmpsf2>
  return write(str);
}

size_t Print::printFloat(double number, uint8_t digits) 
{ 
  size_t n = 0;
     460:	b1 2c       	mov	r11, r1
     462:	a1 2c       	mov	r10, r1
  if (isinf(number)) return print("inf");
  if (number > 4294967040.0) return print ("ovf");  // constant determined empirically
  if (number <-4294967040.0) return print ("ovf");  // constant determined empirically
  
  // Handle negative numbers
  if (number < 0.0)
     464:	87 ff       	sbrs	r24, 7
     466:	0a c0       	rjmp	.+20     	; 0x47c <__LOCK_REGION_LENGTH__+0x7c>
  return write(str);
}

size_t Print::print(char c)
{
  return write(c);
     468:	6d e2       	ldi	r22, 0x2D	; 45
     46a:	8b e5       	ldi	r24, 0x5B	; 91
     46c:	92 e0       	ldi	r25, 0x02	; 2
     46e:	0e 94 ff 00 	call	0x1fe	; 0x1fe <_ZN14HardwareSerial5writeEh>
     472:	5c 01       	movw	r10, r24
  
  // Handle negative numbers
  if (number < 0.0)
  {
     n += print('-');
     number = -number;
     474:	f7 fa       	bst	r15, 7
     476:	f0 94       	com	r15
     478:	f7 f8       	bld	r15, 7
     47a:	f0 94       	com	r15
  // Round correctly so that print(1.999, 2) prints as "2.00"
  double rounding = 0.5;
  for (uint8_t i=0; i<digits; ++i)
    rounding /= 10.0;
  
  number += rounding;
     47c:	2a e0       	ldi	r18, 0x0A	; 10
     47e:	37 ed       	ldi	r19, 0xD7	; 215
     480:	43 ea       	ldi	r20, 0xA3	; 163
     482:	5b e3       	ldi	r21, 0x3B	; 59
     484:	c7 01       	movw	r24, r14
     486:	b6 01       	movw	r22, r12
     488:	0e 94 90 06 	call	0xd20	; 0xd20 <__addsf3>
     48c:	2b 01       	movw	r4, r22
     48e:	3c 01       	movw	r6, r24

  // Extract the integer part of the number and print it
  unsigned long int_part = (unsigned long)number;
     490:	0e 94 7a 07 	call	0xef4	; 0xef4 <__fixunssfsi>
     494:	6b 01       	movw	r12, r22
     496:	7c 01       	movw	r14, r24
  double remainder = number - (double)int_part;
     498:	0e 94 a9 07 	call	0xf52	; 0xf52 <__floatunsisf>
     49c:	9b 01       	movw	r18, r22
     49e:	ac 01       	movw	r20, r24
     4a0:	c3 01       	movw	r24, r6
     4a2:	b2 01       	movw	r22, r4
     4a4:	0e 94 8f 06 	call	0xd1e	; 0xd1e <__subsf3>
     4a8:	2b 01       	movw	r4, r22
     4aa:	3c 01       	movw	r6, r24
}

size_t Print::print(unsigned long n, int base)
{
  if (base == 0) return write(n);
  else return printNumber(n, base);
     4ac:	4a e0       	ldi	r20, 0x0A	; 10
     4ae:	c7 01       	movw	r24, r14
     4b0:	b6 01       	movw	r22, r12
     4b2:	0e 94 79 01 	call	0x2f2	; 0x2f2 <_ZN5Print11printNumberEmh.constprop.24>
  number += rounding;

  // Extract the integer part of the number and print it
  unsigned long int_part = (unsigned long)number;
  double remainder = number - (double)int_part;
  n += print(int_part);
     4b6:	7c 01       	movw	r14, r24
     4b8:	ea 0c       	add	r14, r10
     4ba:	fb 1c       	adc	r15, r11
  return write(str);
}

size_t Print::print(char c)
{
  return write(c);
     4bc:	6e e2       	ldi	r22, 0x2E	; 46
     4be:	8b e5       	ldi	r24, 0x5B	; 91
     4c0:	92 e0       	ldi	r25, 0x02	; 2
     4c2:	0e 94 ff 00 	call	0x1fe	; 0x1fe <_ZN14HardwareSerial5writeEh>
  double remainder = number - (double)int_part;
  n += print(int_part);

  // Print the decimal point, but only if there are digits beyond
  if (digits > 0) {
    n += print('.'); 
     4c6:	e8 0e       	add	r14, r24
     4c8:	f9 1e       	adc	r15, r25
  }

  // Extract digits from the remainder one at a time
  while (digits-- > 0)
  {
    remainder *= 10.0;
     4ca:	20 e0       	ldi	r18, 0x00	; 0
     4cc:	30 e0       	ldi	r19, 0x00	; 0
     4ce:	40 e2       	ldi	r20, 0x20	; 32
     4d0:	51 e4       	ldi	r21, 0x41	; 65
     4d2:	c3 01       	movw	r24, r6
     4d4:	b2 01       	movw	r22, r4
     4d6:	0e 94 60 08 	call	0x10c0	; 0x10c0 <__mulsf3>
     4da:	2b 01       	movw	r4, r22
     4dc:	3c 01       	movw	r6, r24
    unsigned int toPrint = (unsigned int)(remainder);
     4de:	0e 94 7a 07 	call	0xef4	; 0xef4 <__fixunssfsi>
  return print((long) n, base);
}

size_t Print::print(unsigned int n, int base)
{
  return print((unsigned long) n, base);
     4e2:	4b 01       	movw	r8, r22
     4e4:	b1 2c       	mov	r11, r1
     4e6:	a1 2c       	mov	r10, r1
}

size_t Print::print(unsigned long n, int base)
{
  if (base == 0) return write(n);
  else return printNumber(n, base);
     4e8:	4a e0       	ldi	r20, 0x0A	; 10
     4ea:	c5 01       	movw	r24, r10
     4ec:	b4 01       	movw	r22, r8
     4ee:	0e 94 79 01 	call	0x2f2	; 0x2f2 <_ZN5Print11printNumberEmh.constprop.24>
  // Extract digits from the remainder one at a time
  while (digits-- > 0)
  {
    remainder *= 10.0;
    unsigned int toPrint = (unsigned int)(remainder);
    n += print(toPrint);
     4f2:	e8 0e       	add	r14, r24
     4f4:	f9 1e       	adc	r15, r25
    remainder -= toPrint; 
     4f6:	c5 01       	movw	r24, r10
     4f8:	b4 01       	movw	r22, r8
     4fa:	0e 94 a9 07 	call	0xf52	; 0xf52 <__floatunsisf>
     4fe:	9b 01       	movw	r18, r22
     500:	ac 01       	movw	r20, r24
     502:	c3 01       	movw	r24, r6
     504:	b2 01       	movw	r22, r4
     506:	0e 94 8f 06 	call	0xd1e	; 0xd1e <__subsf3>
  }

  // Extract digits from the remainder one at a time
  while (digits-- > 0)
  {
    remainder *= 10.0;
     50a:	20 e0       	ldi	r18, 0x00	; 0
     50c:	30 e0       	ldi	r19, 0x00	; 0
     50e:	40 e2       	ldi	r20, 0x20	; 32
     510:	51 e4       	ldi	r21, 0x41	; 65
     512:	0e 94 60 08 	call	0x10c0	; 0x10c0 <__mulsf3>
    unsigned int toPrint = (unsigned int)(remainder);
     516:	0e 94 7a 07 	call	0xef4	; 0xef4 <__fixunssfsi>
  return print((long) n, base);
}

size_t Print::print(unsigned int n, int base)
{
  return print((unsigned long) n, base);
     51a:	90 e0       	ldi	r25, 0x00	; 0
     51c:	80 e0       	ldi	r24, 0x00	; 0
}

size_t Print::print(unsigned long n, int base)
{
  if (base == 0) return write(n);
  else return printNumber(n, base);
     51e:	4a e0       	ldi	r20, 0x0A	; 10
     520:	0e 94 79 01 	call	0x2f2	; 0x2f2 <_ZN5Print11printNumberEmh.constprop.24>
  // Extract digits from the remainder one at a time
  while (digits-- > 0)
  {
    remainder *= 10.0;
    unsigned int toPrint = (unsigned int)(remainder);
    n += print(toPrint);
     524:	e8 0e       	add	r14, r24
     526:	f9 1e       	adc	r15, r25
     528:	4f cf       	rjmp	.-354    	; 0x3c8 <_ZN5Print7printlnEdi.constprop.11+0x32>

0000052a <__vector_19>:
#elif defined(USART_UDRE_vect)
ISR(USART_UDRE_vect)
#else
  #error "Don't know what the Data Register Empty vector is called for Serial"
#endif
{
     52a:	1f 92       	push	r1
     52c:	0f 92       	push	r0
     52e:	0f b6       	in	r0, 0x3f	; 63
     530:	0f 92       	push	r0
     532:	11 24       	eor	r1, r1
     534:	2f 93       	push	r18
     536:	3f 93       	push	r19
     538:	4f 93       	push	r20
     53a:	5f 93       	push	r21
     53c:	6f 93       	push	r22
     53e:	7f 93       	push	r23
     540:	8f 93       	push	r24
     542:	9f 93       	push	r25
     544:	af 93       	push	r26
     546:	bf 93       	push	r27
     548:	ef 93       	push	r30
     54a:	ff 93       	push	r31
  Serial._tx_udr_empty_irq();
     54c:	8b e5       	ldi	r24, 0x5B	; 91
     54e:	92 e0       	ldi	r25, 0x02	; 2
     550:	0e 94 dd 00 	call	0x1ba	; 0x1ba <_ZN14HardwareSerial17_tx_udr_empty_irqEv>
}
     554:	ff 91       	pop	r31
     556:	ef 91       	pop	r30
     558:	bf 91       	pop	r27
     55a:	af 91       	pop	r26
     55c:	9f 91       	pop	r25
     55e:	8f 91       	pop	r24
     560:	7f 91       	pop	r23
     562:	6f 91       	pop	r22
     564:	5f 91       	pop	r21
     566:	4f 91       	pop	r20
     568:	3f 91       	pop	r19
     56a:	2f 91       	pop	r18
     56c:	0f 90       	pop	r0
     56e:	0f be       	out	0x3f, r0	; 63
     570:	0f 90       	pop	r0
     572:	1f 90       	pop	r1
     574:	18 95       	reti

00000576 <__vector_18>:
#elif defined(USART_RXC_vect)
  ISR(USART_RXC_vect) // ATmega8
#else
  #error "Don't know what the Data Received vector is called for Serial"
#endif
  {
     576:	1f 92       	push	r1
     578:	0f 92       	push	r0
     57a:	0f b6       	in	r0, 0x3f	; 63
     57c:	0f 92       	push	r0
     57e:	11 24       	eor	r1, r1
     580:	2f 93       	push	r18
     582:	8f 93       	push	r24
     584:	9f 93       	push	r25
     586:	ef 93       	push	r30
     588:	ff 93       	push	r31

// Actual interrupt handlers //////////////////////////////////////////////////////////////

void HardwareSerial::_rx_complete_irq(void)
{
  if (bit_is_clear(*_ucsra, UPE0)) {
     58a:	e0 91 6b 02 	lds	r30, 0x026B	; 0x80026b <Serial+0x10>
     58e:	f0 91 6c 02 	lds	r31, 0x026C	; 0x80026c <Serial+0x11>
     592:	80 81       	ld	r24, Z
     594:	e0 91 71 02 	lds	r30, 0x0271	; 0x800271 <Serial+0x16>
     598:	f0 91 72 02 	lds	r31, 0x0272	; 0x800272 <Serial+0x17>
     59c:	82 fd       	sbrc	r24, 2
     59e:	1b c0       	rjmp	.+54     	; 0x5d6 <__vector_18+0x60>
    // No Parity error, read byte and store it in the buffer if there is
    // room
    unsigned char c = *_udr;
     5a0:	90 81       	ld	r25, Z
    rx_buffer_index_t i = (unsigned int)(_rx_buffer_head + 1) % SERIAL_RX_BUFFER_SIZE;
     5a2:	80 91 74 02 	lds	r24, 0x0274	; 0x800274 <Serial+0x19>
     5a6:	8f 5f       	subi	r24, 0xFF	; 255
     5a8:	8f 73       	andi	r24, 0x3F	; 63

    // if we should be storing the received character into the location
    // just before the tail (meaning that the head would advance to the
    // current location of the tail), we're about to overflow the buffer
    // and so we don't write the character or advance the head.
    if (i != _rx_buffer_tail) {
     5aa:	20 91 75 02 	lds	r18, 0x0275	; 0x800275 <Serial+0x1a>
     5ae:	82 17       	cp	r24, r18
     5b0:	41 f0       	breq	.+16     	; 0x5c2 <__vector_18+0x4c>
      _rx_buffer[_rx_buffer_head] = c;
     5b2:	e0 91 74 02 	lds	r30, 0x0274	; 0x800274 <Serial+0x19>
     5b6:	f0 e0       	ldi	r31, 0x00	; 0
     5b8:	e5 5a       	subi	r30, 0xA5	; 165
     5ba:	fd 4f       	sbci	r31, 0xFD	; 253
     5bc:	95 8f       	std	Z+29, r25	; 0x1d
      _rx_buffer_head = i;
     5be:	80 93 74 02 	sts	0x0274, r24	; 0x800274 <Serial+0x19>
    Serial._rx_complete_irq();
  }
     5c2:	ff 91       	pop	r31
     5c4:	ef 91       	pop	r30
     5c6:	9f 91       	pop	r25
     5c8:	8f 91       	pop	r24
     5ca:	2f 91       	pop	r18
     5cc:	0f 90       	pop	r0
     5ce:	0f be       	out	0x3f, r0	; 63
     5d0:	0f 90       	pop	r0
     5d2:	1f 90       	pop	r1
     5d4:	18 95       	reti
    }
  } else {
    // Parity error, read byte but discard it
    *_udr;
     5d6:	80 81       	ld	r24, Z
     5d8:	f4 cf       	rjmp	.-24     	; 0x5c2 <__vector_18+0x4c>

000005da <__vector_16>:
#if defined(TIM0_OVF_vect)
ISR(TIM0_OVF_vect)
#else
ISR(TIMER0_OVF_vect)
#endif
{
     5da:	1f 92       	push	r1
     5dc:	0f 92       	push	r0
     5de:	0f b6       	in	r0, 0x3f	; 63
     5e0:	0f 92       	push	r0
     5e2:	11 24       	eor	r1, r1
     5e4:	2f 93       	push	r18
     5e6:	3f 93       	push	r19
     5e8:	8f 93       	push	r24
     5ea:	9f 93       	push	r25
     5ec:	af 93       	push	r26
     5ee:	bf 93       	push	r27
	// copy these to local variables so they can be stored in registers
	// (volatile variables must be read from memory on every access)
	unsigned long m = timer0_millis;
     5f0:	80 91 39 02 	lds	r24, 0x0239	; 0x800239 <timer0_millis>
     5f4:	90 91 3a 02 	lds	r25, 0x023A	; 0x80023a <timer0_millis+0x1>
     5f8:	a0 91 3b 02 	lds	r26, 0x023B	; 0x80023b <timer0_millis+0x2>
     5fc:	b0 91 3c 02 	lds	r27, 0x023C	; 0x80023c <timer0_millis+0x3>
	unsigned char f = timer0_fract;
     600:	30 91 38 02 	lds	r19, 0x0238	; 0x800238 <timer0_fract>

	m += MILLIS_INC;
	f += FRACT_INC;
     604:	23 e0       	ldi	r18, 0x03	; 3
     606:	23 0f       	add	r18, r19
	if (f >= FRACT_MAX) {
     608:	2d 37       	cpi	r18, 0x7D	; 125
     60a:	58 f5       	brcc	.+86     	; 0x662 <__vector_16+0x88>
	// copy these to local variables so they can be stored in registers
	// (volatile variables must be read from memory on every access)
	unsigned long m = timer0_millis;
	unsigned char f = timer0_fract;

	m += MILLIS_INC;
     60c:	01 96       	adiw	r24, 0x01	; 1
     60e:	a1 1d       	adc	r26, r1
     610:	b1 1d       	adc	r27, r1
	if (f >= FRACT_MAX) {
		f -= FRACT_MAX;
		m += 1;
	}

	timer0_fract = f;
     612:	20 93 38 02 	sts	0x0238, r18	; 0x800238 <timer0_fract>
	timer0_millis = m;
     616:	80 93 39 02 	sts	0x0239, r24	; 0x800239 <timer0_millis>
     61a:	90 93 3a 02 	sts	0x023A, r25	; 0x80023a <timer0_millis+0x1>
     61e:	a0 93 3b 02 	sts	0x023B, r26	; 0x80023b <timer0_millis+0x2>
     622:	b0 93 3c 02 	sts	0x023C, r27	; 0x80023c <timer0_millis+0x3>
	timer0_overflow_count++;
     626:	80 91 34 02 	lds	r24, 0x0234	; 0x800234 <__data_end>
     62a:	90 91 35 02 	lds	r25, 0x0235	; 0x800235 <__data_end+0x1>
     62e:	a0 91 36 02 	lds	r26, 0x0236	; 0x800236 <__data_end+0x2>
     632:	b0 91 37 02 	lds	r27, 0x0237	; 0x800237 <__data_end+0x3>
     636:	01 96       	adiw	r24, 0x01	; 1
     638:	a1 1d       	adc	r26, r1
     63a:	b1 1d       	adc	r27, r1
     63c:	80 93 34 02 	sts	0x0234, r24	; 0x800234 <__data_end>
     640:	90 93 35 02 	sts	0x0235, r25	; 0x800235 <__data_end+0x1>
     644:	a0 93 36 02 	sts	0x0236, r26	; 0x800236 <__data_end+0x2>
     648:	b0 93 37 02 	sts	0x0237, r27	; 0x800237 <__data_end+0x3>
}
     64c:	bf 91       	pop	r27
     64e:	af 91       	pop	r26
     650:	9f 91       	pop	r25
     652:	8f 91       	pop	r24
     654:	3f 91       	pop	r19
     656:	2f 91       	pop	r18
     658:	0f 90       	pop	r0
     65a:	0f be       	out	0x3f, r0	; 63
     65c:	0f 90       	pop	r0
     65e:	1f 90       	pop	r1
     660:	18 95       	reti
	unsigned char f = timer0_fract;

	m += MILLIS_INC;
	f += FRACT_INC;
	if (f >= FRACT_MAX) {
		f -= FRACT_MAX;
     662:	26 e8       	ldi	r18, 0x86	; 134
     664:	23 0f       	add	r18, r19
		m += 1;
     666:	02 96       	adiw	r24, 0x02	; 2
     668:	a1 1d       	adc	r26, r1
     66a:	b1 1d       	adc	r27, r1
     66c:	d2 cf       	rjmp	.-92     	; 0x612 <__vector_16+0x38>

0000066e <main>:

void setupUSB() __attribute__((weak));
void setupUSB() { }

int main(void)
{
     66e:	cf 93       	push	r28
     670:	df 93       	push	r29
     672:	00 d0       	rcall	.+0      	; 0x674 <main+0x6>
     674:	00 d0       	rcall	.+0      	; 0x676 <main+0x8>
     676:	00 d0       	rcall	.+0      	; 0x678 <main+0xa>
     678:	cd b7       	in	r28, 0x3d	; 61
     67a:	de b7       	in	r29, 0x3e	; 62

void init()
{
	// this needs to be called before setup() or some functions won't
	// work there
	sei();
     67c:	78 94       	sei
	
	// on the ATmega168, timer 0 is also used for fast hardware pwm
	// (using phase-correct PWM would mean that timer 0 overflowed half as often
	// resulting in different millis() behavior on the ATmega8 and ATmega168)
#if defined(TCCR0A) && defined(WGM01)
	sbi(TCCR0A, WGM01);
     67e:	84 b5       	in	r24, 0x24	; 36
     680:	82 60       	ori	r24, 0x02	; 2
     682:	84 bd       	out	0x24, r24	; 36
	sbi(TCCR0A, WGM00);
     684:	84 b5       	in	r24, 0x24	; 36
     686:	81 60       	ori	r24, 0x01	; 1
     688:	84 bd       	out	0x24, r24	; 36
	// this combination is for the standard atmega8
	sbi(TCCR0, CS01);
	sbi(TCCR0, CS00);
#elif defined(TCCR0B) && defined(CS01) && defined(CS00)
	// this combination is for the standard 168/328/1280/2560
	sbi(TCCR0B, CS01);
     68a:	85 b5       	in	r24, 0x25	; 37
     68c:	82 60       	ori	r24, 0x02	; 2
     68e:	85 bd       	out	0x25, r24	; 37
	sbi(TCCR0B, CS00);
     690:	85 b5       	in	r24, 0x25	; 37
     692:	81 60       	ori	r24, 0x01	; 1
     694:	85 bd       	out	0x25, r24	; 37

	// enable timer 0 overflow interrupt
#if defined(TIMSK) && defined(TOIE0)
	sbi(TIMSK, TOIE0);
#elif defined(TIMSK0) && defined(TOIE0)
	sbi(TIMSK0, TOIE0);
     696:	80 91 6e 00 	lds	r24, 0x006E	; 0x80006e <__DATA_REGION_ORIGIN__+0xe>
     69a:	81 60       	ori	r24, 0x01	; 1
     69c:	80 93 6e 00 	sts	0x006E, r24	; 0x80006e <__DATA_REGION_ORIGIN__+0xe>
	// this is better for motors as it ensures an even waveform
	// note, however, that fast pwm mode can achieve a frequency of up
	// 8 MHz (with a 16 MHz clock) at 50% duty cycle

#if defined(TCCR1B) && defined(CS11) && defined(CS10)
	TCCR1B = 0;
     6a0:	10 92 81 00 	sts	0x0081, r1	; 0x800081 <__DATA_REGION_ORIGIN__+0x21>

	// set timer 1 prescale factor to 64
	sbi(TCCR1B, CS11);
     6a4:	80 91 81 00 	lds	r24, 0x0081	; 0x800081 <__DATA_REGION_ORIGIN__+0x21>
     6a8:	82 60       	ori	r24, 0x02	; 2
     6aa:	80 93 81 00 	sts	0x0081, r24	; 0x800081 <__DATA_REGION_ORIGIN__+0x21>
#if F_CPU >= 8000000L
	sbi(TCCR1B, CS10);
     6ae:	80 91 81 00 	lds	r24, 0x0081	; 0x800081 <__DATA_REGION_ORIGIN__+0x21>
     6b2:	81 60       	ori	r24, 0x01	; 1
     6b4:	80 93 81 00 	sts	0x0081, r24	; 0x800081 <__DATA_REGION_ORIGIN__+0x21>
	sbi(TCCR1, CS10);
#endif
#endif
	// put timer 1 in 8-bit phase correct pwm mode
#if defined(TCCR1A) && defined(WGM10)
	sbi(TCCR1A, WGM10);
     6b8:	80 91 80 00 	lds	r24, 0x0080	; 0x800080 <__DATA_REGION_ORIGIN__+0x20>
     6bc:	81 60       	ori	r24, 0x01	; 1
     6be:	80 93 80 00 	sts	0x0080, r24	; 0x800080 <__DATA_REGION_ORIGIN__+0x20>

	// set timer 2 prescale factor to 64
#if defined(TCCR2) && defined(CS22)
	sbi(TCCR2, CS22);
#elif defined(TCCR2B) && defined(CS22)
	sbi(TCCR2B, CS22);
     6c2:	80 91 b1 00 	lds	r24, 0x00B1	; 0x8000b1 <__DATA_REGION_ORIGIN__+0x51>
     6c6:	84 60       	ori	r24, 0x04	; 4
     6c8:	80 93 b1 00 	sts	0x00B1, r24	; 0x8000b1 <__DATA_REGION_ORIGIN__+0x51>

	// configure timer 2 for phase correct pwm (8-bit)
#if defined(TCCR2) && defined(WGM20)
	sbi(TCCR2, WGM20);
#elif defined(TCCR2A) && defined(WGM20)
	sbi(TCCR2A, WGM20);
     6cc:	80 91 b0 00 	lds	r24, 0x00B0	; 0x8000b0 <__DATA_REGION_ORIGIN__+0x50>
     6d0:	81 60       	ori	r24, 0x01	; 1
     6d2:	80 93 b0 00 	sts	0x00B0, r24	; 0x8000b0 <__DATA_REGION_ORIGIN__+0x50>
#endif

#if defined(ADCSRA)
	// set a2d prescaler so we are inside the desired 50-200 KHz range.
	#if F_CPU >= 16000000 // 16 MHz / 128 = 125 KHz
		sbi(ADCSRA, ADPS2);
     6d6:	80 91 7a 00 	lds	r24, 0x007A	; 0x80007a <__DATA_REGION_ORIGIN__+0x1a>
     6da:	84 60       	ori	r24, 0x04	; 4
     6dc:	80 93 7a 00 	sts	0x007A, r24	; 0x80007a <__DATA_REGION_ORIGIN__+0x1a>
		sbi(ADCSRA, ADPS1);
     6e0:	80 91 7a 00 	lds	r24, 0x007A	; 0x80007a <__DATA_REGION_ORIGIN__+0x1a>
     6e4:	82 60       	ori	r24, 0x02	; 2
     6e6:	80 93 7a 00 	sts	0x007A, r24	; 0x80007a <__DATA_REGION_ORIGIN__+0x1a>
		sbi(ADCSRA, ADPS0);
     6ea:	80 91 7a 00 	lds	r24, 0x007A	; 0x80007a <__DATA_REGION_ORIGIN__+0x1a>
     6ee:	81 60       	ori	r24, 0x01	; 1
     6f0:	80 93 7a 00 	sts	0x007A, r24	; 0x80007a <__DATA_REGION_ORIGIN__+0x1a>
		cbi(ADCSRA, ADPS2);
		cbi(ADCSRA, ADPS1);
		sbi(ADCSRA, ADPS0);
	#endif
	// enable a2d conversions
	sbi(ADCSRA, ADEN);
     6f4:	80 91 7a 00 	lds	r24, 0x007A	; 0x80007a <__DATA_REGION_ORIGIN__+0x1a>
     6f8:	80 68       	ori	r24, 0x80	; 128
     6fa:	80 93 7a 00 	sts	0x007A, r24	; 0x80007a <__DATA_REGION_ORIGIN__+0x1a>
	// here so they can be used as normal digital i/o; they will be
	// reconnected in Serial.begin()
#if defined(UCSRB)
	UCSRB = 0;
#elif defined(UCSR0B)
	UCSR0B = 0;
     6fe:	10 92 c1 00 	sts	0x00C1, r1	; 0x8000c1 <__DATA_REGION_ORIGIN__+0x61>

void HardwareSerial::begin(unsigned long baud, byte config)
{
  // Try u2x mode first
  uint16_t baud_setting = (F_CPU / 4 / baud - 1) / 2;
  *_ucsra = 1 << U2X0;
     702:	e0 91 6b 02 	lds	r30, 0x026B	; 0x80026b <Serial+0x10>
     706:	f0 91 6c 02 	lds	r31, 0x026C	; 0x80026c <Serial+0x11>
     70a:	82 e0       	ldi	r24, 0x02	; 2
     70c:	80 83       	st	Z, r24
    *_ucsra = 0;
    baud_setting = (F_CPU / 8 / baud - 1) / 2;
  }

  // assign the baud_setting, a.k.a. ubrr (USART Baud Rate Register)
  *_ubrrh = baud_setting >> 8;
     70e:	e0 91 67 02 	lds	r30, 0x0267	; 0x800267 <Serial+0xc>
     712:	f0 91 68 02 	lds	r31, 0x0268	; 0x800268 <Serial+0xd>
     716:	10 82       	st	Z, r1
  *_ubrrl = baud_setting;
     718:	e0 91 69 02 	lds	r30, 0x0269	; 0x800269 <Serial+0xe>
     71c:	f0 91 6a 02 	lds	r31, 0x026A	; 0x80026a <Serial+0xf>
     720:	8f ec       	ldi	r24, 0xCF	; 207
     722:	80 83       	st	Z, r24

  _written = false;
     724:	10 92 73 02 	sts	0x0273, r1	; 0x800273 <Serial+0x18>

  //set the data bits, parity, and stop bits
#if defined(__AVR_ATmega8__)
  config |= 0x80; // select UCSRC register (shared with UBRRH)
#endif
  *_ucsrc = config;
     728:	e0 91 6f 02 	lds	r30, 0x026F	; 0x80026f <Serial+0x14>
     72c:	f0 91 70 02 	lds	r31, 0x0270	; 0x800270 <Serial+0x15>
     730:	86 e0       	ldi	r24, 0x06	; 6
     732:	80 83       	st	Z, r24
  
  sbi(*_ucsrb, RXEN0);
     734:	e0 91 6d 02 	lds	r30, 0x026D	; 0x80026d <Serial+0x12>
     738:	f0 91 6e 02 	lds	r31, 0x026E	; 0x80026e <Serial+0x13>
     73c:	80 81       	ld	r24, Z
     73e:	80 61       	ori	r24, 0x10	; 16
     740:	80 83       	st	Z, r24
  sbi(*_ucsrb, TXEN0);
     742:	e0 91 6d 02 	lds	r30, 0x026D	; 0x80026d <Serial+0x12>
     746:	f0 91 6e 02 	lds	r31, 0x026E	; 0x80026e <Serial+0x13>
     74a:	80 81       	ld	r24, Z
     74c:	88 60       	ori	r24, 0x08	; 8
     74e:	80 83       	st	Z, r24
  sbi(*_ucsrb, RXCIE0);
     750:	e0 91 6d 02 	lds	r30, 0x026D	; 0x80026d <Serial+0x12>
     754:	f0 91 6e 02 	lds	r31, 0x026E	; 0x80026e <Serial+0x13>
     758:	80 81       	ld	r24, Z
     75a:	80 68       	ori	r24, 0x80	; 128
     75c:	80 83       	st	Z, r24
  cbi(*_ucsrb, UDRIE0);
     75e:	e0 91 6d 02 	lds	r30, 0x026D	; 0x80026d <Serial+0x12>
     762:	f0 91 6e 02 	lds	r31, 0x026E	; 0x80026e <Serial+0x13>
     766:	80 81       	ld	r24, Z
     768:	8f 7d       	andi	r24, 0xDF	; 223
     76a:	80 83       	st	Z, r24
  productFixed = prod;
}

void setup() {
  Serial.begin(9600);
  Serial.println("Initializing...");
     76c:	8d e2       	ldi	r24, 0x2D	; 45
     76e:	91 e0       	ldi	r25, 0x01	; 1
     770:	0e 94 bd 01 	call	0x37a	; 0x37a <_ZN5Print7printlnEPKc.constprop.18>

  Serial.println("Generating random floats...");
     774:	8d e3       	ldi	r24, 0x3D	; 61
     776:	91 e0       	ldi	r25, 0x01	; 1
     778:	0e 94 bd 01 	call	0x37a	; 0x37a <_ZN5Print7printlnEPKc.constprop.18>
	// to 0 (the default).
#if defined(ADMUX)
#if defined(__AVR_ATtiny25__) || defined(__AVR_ATtiny45__) || defined(__AVR_ATtiny85__)
	ADMUX = (analog_reference << 4) | (pin & 0x07);
#else
	ADMUX = (analog_reference << 6) | (pin & 0x07);
     77c:	80 e4       	ldi	r24, 0x40	; 64
     77e:	80 93 7c 00 	sts	0x007C, r24	; 0x80007c <__DATA_REGION_ORIGIN__+0x1c>
	// without a delay, we seem to read from the wrong channel
	//delay(1);

#if defined(ADCSRA) && defined(ADCL)
	// start the conversion
	sbi(ADCSRA, ADSC);
     782:	80 91 7a 00 	lds	r24, 0x007A	; 0x80007a <__DATA_REGION_ORIGIN__+0x1a>
     786:	80 64       	ori	r24, 0x40	; 64
     788:	80 93 7a 00 	sts	0x007A, r24	; 0x80007a <__DATA_REGION_ORIGIN__+0x1a>

	// ADSC is cleared when the conversion finishes
	while (bit_is_set(ADCSRA, ADSC));
     78c:	80 91 7a 00 	lds	r24, 0x007A	; 0x80007a <__DATA_REGION_ORIGIN__+0x1a>
     790:	86 fd       	sbrc	r24, 6
     792:	fc cf       	rjmp	.-8      	; 0x78c <main+0x11e>

	// we have to read ADCL first; doing so locks both ADCL
	// and ADCH until ADCH is read.  reading ADCL second would
	// cause the results of each conversion to be discarded,
	// as ADCL and ADCH would be locked when it completed.
	low  = ADCL;
     794:	80 91 78 00 	lds	r24, 0x0078	; 0x800078 <__DATA_REGION_ORIGIN__+0x18>
	high = ADCH;
     798:	60 91 79 00 	lds	r22, 0x0079	; 0x800079 <__DATA_REGION_ORIGIN__+0x19>
	low  = 0;
	high = 0;
#endif

	// combine the two bytes
	return (high << 8) | low;
     79c:	76 2f       	mov	r23, r22
     79e:	68 2f       	mov	r22, r24

  randomSeed(analogRead(0));  
     7a0:	07 2e       	mov	r0, r23
     7a2:	00 0c       	add	r0, r0
     7a4:	88 0b       	sbc	r24, r24
     7a6:	99 0b       	sbc	r25, r25
  #include "stdlib.h"
}

void randomSeed(unsigned long seed)
{
  if (seed != 0) {
     7a8:	61 15       	cp	r22, r1
     7aa:	71 05       	cpc	r23, r1
     7ac:	81 05       	cpc	r24, r1
     7ae:	91 05       	cpc	r25, r1
     7b0:	11 f0       	breq	.+4      	; 0x7b6 <main+0x148>
    srandom(seed);
     7b2:	0e 94 23 06 	call	0xc46	; 0xc46 <srandom>
     7b6:	67 e4       	ldi	r22, 0x47	; 71
     7b8:	26 2e       	mov	r2, r22
     7ba:	62 e0       	ldi	r22, 0x02	; 2
     7bc:	36 2e       	mov	r3, r22
     7be:	3a 82       	std	Y+2, r3	; 0x02
     7c0:	29 82       	std	Y+1, r2	; 0x01
long random(long howbig)
{
  if (howbig == 0) {
    return 0;
  }
  return random() % howbig;
     7c2:	73 e6       	ldi	r23, 0x63	; 99
     7c4:	c7 2e       	mov	r12, r23
     7c6:	d1 2c       	mov	r13, r1
     7c8:	e1 2c       	mov	r14, r1
     7ca:	f1 2c       	mov	r15, r1
     7cc:	0e 94 d4 05 	call	0xba8	; 0xba8 <random>
     7d0:	a7 01       	movw	r20, r14
     7d2:	96 01       	movw	r18, r12
     7d4:	0e 94 2c 06 	call	0xc58	; 0xc58 <__divmodsi4>
{
  if (howsmall >= howbig) {
    return howsmall;
  }
  long diff = howbig - howsmall;
  return random(diff) + howsmall;
     7d8:	6f 5f       	subi	r22, 0xFF	; 255
     7da:	7f 4f       	sbci	r23, 0xFF	; 255
     7dc:	8f 4f       	sbci	r24, 0xFF	; 255
     7de:	9f 4f       	sbci	r25, 0xFF	; 255
  for (unsigned int i = 0; i < SIZE; i++)
    listFloat[i] = random(1, 100) / 10.0f;
     7e0:	0e 94 ab 07 	call	0xf56	; 0xf56 <__floatsisf>
     7e4:	20 e0       	ldi	r18, 0x00	; 0
     7e6:	30 e0       	ldi	r19, 0x00	; 0
     7e8:	40 e2       	ldi	r20, 0x20	; 32
     7ea:	51 e4       	ldi	r21, 0x41	; 65
     7ec:	0e 94 01 07 	call	0xe02	; 0xe02 <__divsf3>
     7f0:	e9 81       	ldd	r30, Y+1	; 0x01
     7f2:	fa 81       	ldd	r31, Y+2	; 0x02
     7f4:	61 93       	st	Z+, r22
     7f6:	71 93       	st	Z+, r23
     7f8:	81 93       	st	Z+, r24
     7fa:	91 93       	st	Z+, r25
     7fc:	fa 83       	std	Y+2, r31	; 0x02
     7fe:	e9 83       	std	Y+1, r30	; 0x01
  Serial.println("Initializing...");

  Serial.println("Generating random floats...");

  randomSeed(analogRead(0));  
  for (unsigned int i = 0; i < SIZE; i++)
     800:	eb 55       	subi	r30, 0x5B	; 91
     802:	f2 40       	sbci	r31, 0x02	; 2
     804:	19 f7       	brne	.-58     	; 0x7cc <main+0x15e>
    Serial.println(arr[i]);
}

void displayList(float* arr)
{
  Serial.println("Printing the list of floats...");
     806:	89 e5       	ldi	r24, 0x59	; 89
     808:	91 e0       	ldi	r25, 0x01	; 1
     80a:	0e 94 bd 01 	call	0x37a	; 0x37a <_ZN5Print7printlnEPKc.constprop.18>
     80e:	07 e4       	ldi	r16, 0x47	; 71
     810:	12 e0       	ldi	r17, 0x02	; 2
  
  for (unsigned int i = 0; i < SIZE; i++)
    Serial.println(arr[i], 2);
     812:	f8 01       	movw	r30, r16
     814:	61 91       	ld	r22, Z+
     816:	71 91       	ld	r23, Z+
     818:	81 91       	ld	r24, Z+
     81a:	91 91       	ld	r25, Z+
     81c:	8f 01       	movw	r16, r30
     81e:	0e 94 cb 01 	call	0x396	; 0x396 <_ZN5Print7printlnEdi.constprop.11>

void displayList(float* arr)
{
  Serial.println("Printing the list of floats...");
  
  for (unsigned int i = 0; i < SIZE; i++)
     822:	29 81       	ldd	r18, Y+1	; 0x01
     824:	3a 81       	ldd	r19, Y+2	; 0x02
     826:	20 17       	cp	r18, r16
     828:	31 07       	cpc	r19, r17
     82a:	99 f7       	brne	.-26     	; 0x812 <main+0x1a4>
  for (unsigned int i = 0; i < SIZE; i++)
    listFloat[i] = random(1, 100) / 10.0f;

  displayList(listFloat);

  Serial.println("Getting product using floating point arithmetic...");
     82c:	88 e7       	ldi	r24, 0x78	; 120
     82e:	91 e0       	ldi	r25, 0x01	; 1
     830:	0e 94 bd 01 	call	0x37a	; 0x37a <_ZN5Print7printlnEPKc.constprop.18>
}

unsigned long millis()
{
	unsigned long m;
	uint8_t oldSREG = SREG;
     834:	8f b7       	in	r24, 0x3f	; 63

	// disable interrupts while we read timer0_millis or we might get an
	// inconsistent value (e.g. in the middle of a write to timer0_millis)
	cli();
     836:	f8 94       	cli
	m = timer0_millis;
     838:	20 91 39 02 	lds	r18, 0x0239	; 0x800239 <timer0_millis>
     83c:	30 91 3a 02 	lds	r19, 0x023A	; 0x80023a <timer0_millis+0x1>
     840:	40 91 3b 02 	lds	r20, 0x023B	; 0x80023b <timer0_millis+0x2>
     844:	50 91 3c 02 	lds	r21, 0x023C	; 0x80023c <timer0_millis+0x3>
     848:	29 83       	std	Y+1, r18	; 0x01
     84a:	3a 83       	std	Y+2, r19	; 0x02
     84c:	4b 83       	std	Y+3, r20	; 0x03
     84e:	5c 83       	std	Y+4, r21	; 0x04
	SREG = oldSREG;
     850:	8f bf       	out	0x3f, r24	; 63
     852:	50 e4       	ldi	r21, 0x40	; 64
     854:	85 2e       	mov	r8, r21
     856:	5d e0       	ldi	r21, 0x0D	; 13
     858:	95 2e       	mov	r9, r21
     85a:	53 e0       	ldi	r21, 0x03	; 3
     85c:	a5 2e       	mov	r10, r21
     85e:	b1 2c       	mov	r11, r1
     860:	47 e4       	ldi	r20, 0x47	; 71
     862:	52 e0       	ldi	r21, 0x02	; 2
     864:	5e 83       	std	Y+6, r21	; 0x06
     866:	4d 83       	std	Y+5, r20	; 0x05
void multiplyFloat(float *arr)
{
  float prod = 1.0;
  for (unsigned long i = 0; i < MAX_LOOP; i++)
  {
    prod = 1.0f;
     868:	c1 2c       	mov	r12, r1
     86a:	d1 2c       	mov	r13, r1
     86c:	40 e8       	ldi	r20, 0x80	; 128
     86e:	e4 2e       	mov	r14, r20
     870:	4f e3       	ldi	r20, 0x3F	; 63
     872:	f4 2e       	mov	r15, r20
    for (unsigned int j = 0; j < SIZE; j++) 
      if (arr[j] > 0.0f)
     874:	ed 81       	ldd	r30, Y+5	; 0x05
     876:	fe 81       	ldd	r31, Y+6	; 0x06
     878:	41 90       	ld	r4, Z+
     87a:	51 90       	ld	r5, Z+
     87c:	61 90       	ld	r6, Z+
     87e:	71 90       	ld	r7, Z+
     880:	fe 83       	std	Y+6, r31	; 0x06
     882:	ed 83       	std	Y+5, r30	; 0x05
     884:	20 e0       	ldi	r18, 0x00	; 0
     886:	30 e0       	ldi	r19, 0x00	; 0
     888:	a9 01       	movw	r20, r18
     88a:	c3 01       	movw	r24, r6
     88c:	b2 01       	movw	r22, r4
     88e:	0e 94 5b 08 	call	0x10b6	; 0x10b6 <__gesf2>
     892:	18 16       	cp	r1, r24
     894:	44 f4       	brge	.+16     	; 0x8a6 <main+0x238>
        prod *= arr[j];
     896:	a3 01       	movw	r20, r6
     898:	92 01       	movw	r18, r4
     89a:	c7 01       	movw	r24, r14
     89c:	b6 01       	movw	r22, r12
     89e:	0e 94 60 08 	call	0x10c0	; 0x10c0 <__mulsf3>
     8a2:	6b 01       	movw	r12, r22
     8a4:	7c 01       	movw	r14, r24
{
  float prod = 1.0;
  for (unsigned long i = 0; i < MAX_LOOP; i++)
  {
    prod = 1.0f;
    for (unsigned int j = 0; j < SIZE; j++) 
     8a6:	2d 81       	ldd	r18, Y+5	; 0x05
     8a8:	3e 81       	ldd	r19, Y+6	; 0x06
     8aa:	20 17       	cp	r18, r16
     8ac:	31 07       	cpc	r19, r17
     8ae:	11 f7       	brne	.-60     	; 0x874 <main+0x206>
     8b0:	31 e0       	ldi	r19, 0x01	; 1
     8b2:	83 1a       	sub	r8, r19
     8b4:	91 08       	sbc	r9, r1
     8b6:	a1 08       	sbc	r10, r1
     8b8:	b1 08       	sbc	r11, r1
}

void multiplyFloat(float *arr)
{
  float prod = 1.0;
  for (unsigned long i = 0; i < MAX_LOOP; i++)
     8ba:	91 f6       	brne	.-92     	; 0x860 <main+0x1f2>
    for (unsigned int j = 0; j < SIZE; j++) 
      if (arr[j] > 0.0f)
        prod *= arr[j];
  }

  productFloat = prod;
     8bc:	c0 92 04 01 	sts	0x0104, r12	; 0x800104 <productFloat>
     8c0:	d0 92 05 01 	sts	0x0105, r13	; 0x800105 <productFloat+0x1>
     8c4:	e0 92 06 01 	sts	0x0106, r14	; 0x800106 <productFloat+0x2>
     8c8:	f0 92 07 01 	sts	0x0107, r15	; 0x800107 <productFloat+0x3>
}

unsigned long millis()
{
	unsigned long m;
	uint8_t oldSREG = SREG;
     8cc:	8f b7       	in	r24, 0x3f	; 63

	// disable interrupts while we read timer0_millis or we might get an
	// inconsistent value (e.g. in the middle of a write to timer0_millis)
	cli();
     8ce:	f8 94       	cli
	m = timer0_millis;
     8d0:	c0 90 39 02 	lds	r12, 0x0239	; 0x800239 <timer0_millis>
     8d4:	d0 90 3a 02 	lds	r13, 0x023A	; 0x80023a <timer0_millis+0x1>
     8d8:	e0 90 3b 02 	lds	r14, 0x023B	; 0x80023b <timer0_millis+0x2>
     8dc:	f0 90 3c 02 	lds	r15, 0x023C	; 0x80023c <timer0_millis+0x3>
	SREG = oldSREG;
     8e0:	8f bf       	out	0x3f, r24	; 63
     8e2:	8b ea       	ldi	r24, 0xAB	; 171
     8e4:	91 e0       	ldi	r25, 0x01	; 1
     8e6:	0e 94 6c 01 	call	0x2d8	; 0x2d8 <_ZN5Print5writeEPKc.part.2.constprop.27>
  multiplyFloat(listFloat);

  unsigned long stopTimeFloat = millis();  

  Serial.print("The product is: ");
  Serial.println(productFloat, 2);
     8ea:	60 91 04 01 	lds	r22, 0x0104	; 0x800104 <productFloat>
     8ee:	70 91 05 01 	lds	r23, 0x0105	; 0x800105 <productFloat+0x1>
     8f2:	80 91 06 01 	lds	r24, 0x0106	; 0x800106 <productFloat+0x2>
     8f6:	90 91 07 01 	lds	r25, 0x0107	; 0x800107 <productFloat+0x3>
     8fa:	0e 94 cb 01 	call	0x396	; 0x396 <_ZN5Print7printlnEdi.constprop.11>
  Serial.println("Time taken in ms: ");
     8fe:	8c eb       	ldi	r24, 0xBC	; 188
     900:	91 e0       	ldi	r25, 0x01	; 1
     902:	0e 94 bd 01 	call	0x37a	; 0x37a <_ZN5Print7printlnEPKc.constprop.18>
  Serial.println(stopTimeFloat - startTimeFloat);
     906:	c7 01       	movw	r24, r14
     908:	b6 01       	movw	r22, r12
     90a:	29 81       	ldd	r18, Y+1	; 0x01
     90c:	3a 81       	ldd	r19, Y+2	; 0x02
     90e:	4b 81       	ldd	r20, Y+3	; 0x03
     910:	5c 81       	ldd	r21, Y+4	; 0x04
     912:	62 1b       	sub	r22, r18
     914:	73 0b       	sbc	r23, r19
     916:	84 0b       	sbc	r24, r20
     918:	95 0b       	sbc	r25, r21
}

size_t Print::print(unsigned long n, int base)
{
  if (base == 0) return write(n);
  else return printNumber(n, base);
     91a:	4a e0       	ldi	r20, 0x0A	; 10
     91c:	0e 94 79 01 	call	0x2f2	; 0x2f2 <_ZN5Print11printNumberEmh.constprop.24>
     920:	8e e1       	ldi	r24, 0x1E	; 30
     922:	91 e0       	ldi	r25, 0x01	; 1
     924:	0e 94 6c 01 	call	0x2d8	; 0x2d8 <_ZN5Print5writeEPKc.part.2.constprop.27>
  //////////////////////////////////////////////////////////////////////////////////////

  // testFloatToFixed();
  // testMulFixed();

  Serial.println("Processing list...");
     928:	8f ec       	ldi	r24, 0xCF	; 207
     92a:	91 e0       	ldi	r25, 0x01	; 1
     92c:	0e 94 bd 01 	call	0x37a	; 0x37a <_ZN5Print7printlnEPKc.constprop.18>
     930:	4d e3       	ldi	r20, 0x3D	; 61
     932:	52 e0       	ldi	r21, 0x02	; 2
     934:	5a 83       	std	Y+2, r21	; 0x02
     936:	49 83       	std	Y+1, r20	; 0x01

  for (unsigned int i = 0; i < SIZE; i++)
    listFixed[i] = floatToFixed(listFloat[i]);
     938:	f1 01       	movw	r30, r2
     93a:	61 91       	ld	r22, Z+
     93c:	71 91       	ld	r23, Z+
     93e:	81 91       	ld	r24, Z+
     940:	91 91       	ld	r25, Z+
     942:	1f 01       	movw	r2, r30
float productFloat = 1.0f;
unsigned long productFixed = 1;

int floatToFixed(float x)
{
  return (x * (1 << SCALE));
     944:	20 e0       	ldi	r18, 0x00	; 0
     946:	30 e0       	ldi	r19, 0x00	; 0
     948:	40 e8       	ldi	r20, 0x80	; 128
     94a:	53 e4       	ldi	r21, 0x43	; 67
     94c:	0e 94 60 08 	call	0x10c0	; 0x10c0 <__mulsf3>
     950:	0e 94 73 07 	call	0xee6	; 0xee6 <__fixsfsi>
     954:	e9 81       	ldd	r30, Y+1	; 0x01
     956:	fa 81       	ldd	r31, Y+2	; 0x02
     958:	61 93       	st	Z+, r22
     95a:	71 93       	st	Z+, r23
     95c:	fa 83       	std	Y+2, r31	; 0x02
     95e:	e9 83       	std	Y+1, r30	; 0x01
  // testFloatToFixed();
  // testMulFixed();

  Serial.println("Processing list...");

  for (unsigned int i = 0; i < SIZE; i++)
     960:	20 16       	cp	r2, r16
     962:	31 06       	cpc	r3, r17
     964:	49 f7       	brne	.-46     	; 0x938 <__stack+0x39>
  Serial.println(xyFixedToFloat);
}

void displayList(int* arr)
{
  Serial.println("Printing the list of integers...");
     966:	82 ee       	ldi	r24, 0xE2	; 226
     968:	91 e0       	ldi	r25, 0x01	; 1
     96a:	0e 94 bd 01 	call	0x37a	; 0x37a <_ZN5Print7printlnEPKc.constprop.18>
     96e:	07 e4       	ldi	r16, 0x47	; 71
     970:	12 e0       	ldi	r17, 0x02	; 2
     972:	2d e3       	ldi	r18, 0x3D	; 61
     974:	32 e0       	ldi	r19, 0x02	; 2
     976:	3a 83       	std	Y+2, r19	; 0x02
     978:	29 83       	std	Y+1, r18	; 0x01
  
  for (unsigned int i = 0; i < SIZE; i++)
    Serial.println(arr[i]);
     97a:	e9 81       	ldd	r30, Y+1	; 0x01
     97c:	fa 81       	ldd	r31, Y+2	; 0x02
     97e:	c1 90       	ld	r12, Z+
     980:	d1 90       	ld	r13, Z+
     982:	fa 83       	std	Y+2, r31	; 0x02
     984:	e9 83       	std	Y+1, r30	; 0x01
  return print((unsigned long) b, base);
}

size_t Print::print(int n, int base)
{
  return print((long) n, base);
     986:	0d 2c       	mov	r0, r13
     988:	00 0c       	add	r0, r0
     98a:	ee 08       	sbc	r14, r14
     98c:	ff 08       	sbc	r15, r15
    if (n < 0) {
      int t = print('-');
      n = -n;
      return printNumber(n, 10) + t;
    }
    return printNumber(n, 10);
     98e:	4a e0       	ldi	r20, 0x0A	; 10
     990:	c7 01       	movw	r24, r14
     992:	b6 01       	movw	r22, r12
size_t Print::print(long n, int base)
{
  if (base == 0) {
    return write(n);
  } else if (base == 10) {
    if (n < 0) {
     994:	f7 fe       	sbrs	r15, 7
     996:	0d c0       	rjmp	.+26     	; 0x9b2 <__stack+0xb3>
  return write(str);
}

size_t Print::print(char c)
{
  return write(c);
     998:	6d e2       	ldi	r22, 0x2D	; 45
     99a:	8b e5       	ldi	r24, 0x5B	; 91
     99c:	92 e0       	ldi	r25, 0x02	; 2
     99e:	0e 94 ff 00 	call	0x1fe	; 0x1fe <_ZN14HardwareSerial5writeEh>
  if (base == 0) {
    return write(n);
  } else if (base == 10) {
    if (n < 0) {
      int t = print('-');
      n = -n;
     9a2:	66 27       	eor	r22, r22
     9a4:	77 27       	eor	r23, r23
     9a6:	cb 01       	movw	r24, r22
     9a8:	6c 19       	sub	r22, r12
     9aa:	7d 09       	sbc	r23, r13
     9ac:	8e 09       	sbc	r24, r14
     9ae:	9f 09       	sbc	r25, r15
      return printNumber(n, 10) + t;
     9b0:	4a e0       	ldi	r20, 0x0A	; 10
    }
    return printNumber(n, 10);
     9b2:	0e 94 79 01 	call	0x2f2	; 0x2f2 <_ZN5Print11printNumberEmh.constprop.24>
     9b6:	8e e1       	ldi	r24, 0x1E	; 30
     9b8:	91 e0       	ldi	r25, 0x01	; 1
     9ba:	0e 94 6c 01 	call	0x2d8	; 0x2d8 <_ZN5Print5writeEPKc.part.2.constprop.27>

void displayList(int* arr)
{
  Serial.println("Printing the list of integers...");
  
  for (unsigned int i = 0; i < SIZE; i++)
     9be:	29 81       	ldd	r18, Y+1	; 0x01
     9c0:	3a 81       	ldd	r19, Y+2	; 0x02
     9c2:	02 17       	cp	r16, r18
     9c4:	13 07       	cpc	r17, r19
     9c6:	c9 f6       	brne	.-78     	; 0x97a <__stack+0x7b>
  for (unsigned int i = 0; i < SIZE; i++)
    listFixed[i] = floatToFixed(listFloat[i]);

  displayList(listFixed);
  
  Serial.println("Getting product using fixed point arithmetic...");
     9c8:	83 e0       	ldi	r24, 0x03	; 3
     9ca:	92 e0       	ldi	r25, 0x02	; 2
     9cc:	0e 94 bd 01 	call	0x37a	; 0x37a <_ZN5Print7printlnEPKc.constprop.18>
}

unsigned long millis()
{
	unsigned long m;
	uint8_t oldSREG = SREG;
     9d0:	8f b7       	in	r24, 0x3f	; 63

	// disable interrupts while we read timer0_millis or we might get an
	// inconsistent value (e.g. in the middle of a write to timer0_millis)
	cli();
     9d2:	f8 94       	cli
	m = timer0_millis;
     9d4:	80 90 39 02 	lds	r8, 0x0239	; 0x800239 <timer0_millis>
     9d8:	90 90 3a 02 	lds	r9, 0x023A	; 0x80023a <timer0_millis+0x1>
     9dc:	a0 90 3b 02 	lds	r10, 0x023B	; 0x80023b <timer0_millis+0x2>
     9e0:	b0 90 3c 02 	lds	r11, 0x023C	; 0x80023c <timer0_millis+0x3>
	SREG = oldSREG;
     9e4:	8f bf       	out	0x3f, r24	; 63
     9e6:	30 e4       	ldi	r19, 0x40	; 64
     9e8:	c3 2e       	mov	r12, r19
     9ea:	3d e0       	ldi	r19, 0x0D	; 13
     9ec:	d3 2e       	mov	r13, r19
     9ee:	33 e0       	ldi	r19, 0x03	; 3
     9f0:	e3 2e       	mov	r14, r19
     9f2:	f1 2c       	mov	r15, r1
     9f4:	ed e3       	ldi	r30, 0x3D	; 61
     9f6:	f2 e0       	ldi	r31, 0x02	; 2
void multiplyFixed(int *arr)
{
  unsigned long prod = 1;
  for (unsigned long i = 0; i < MAX_LOOP; i++)
  {
    prod = 1;
     9f8:	21 e0       	ldi	r18, 0x01	; 1
     9fa:	30 e0       	ldi	r19, 0x00	; 0
     9fc:	40 e0       	ldi	r20, 0x00	; 0
     9fe:	50 e0       	ldi	r21, 0x00	; 0
    for (unsigned int j = 0; j < SIZE; j++) 
      if (arr[j] > 0)
     a00:	a1 91       	ld	r26, Z+
     a02:	b1 91       	ld	r27, Z+
     a04:	1a 16       	cp	r1, r26
     a06:	1b 06       	cpc	r1, r27
     a08:	34 f4       	brge	.+12     	; 0xa16 <__stack+0x117>
  Serial.println(z);
}

unsigned long mulFixed(unsigned long x , unsigned long y)
{
  return ((unsigned long) x * (unsigned long) y) >> SCALE;
     a0a:	0e 94 56 06 	call	0xcac	; 0xcac <__mulshisi3>
     a0e:	27 2f       	mov	r18, r23
     a10:	38 2f       	mov	r19, r24
     a12:	49 2f       	mov	r20, r25
     a14:	55 27       	eor	r21, r21
{
  unsigned long prod = 1;
  for (unsigned long i = 0; i < MAX_LOOP; i++)
  {
    prod = 1;
    for (unsigned int j = 0; j < SIZE; j++) 
     a16:	89 81       	ldd	r24, Y+1	; 0x01
     a18:	9a 81       	ldd	r25, Y+2	; 0x02
     a1a:	e8 17       	cp	r30, r24
     a1c:	f9 07       	cpc	r31, r25
     a1e:	81 f7       	brne	.-32     	; 0xa00 <__stack+0x101>
     a20:	91 e0       	ldi	r25, 0x01	; 1
     a22:	c9 1a       	sub	r12, r25
     a24:	d1 08       	sbc	r13, r1
     a26:	e1 08       	sbc	r14, r1
     a28:	f1 08       	sbc	r15, r1
}

void multiplyFixed(int *arr)
{
  unsigned long prod = 1;
  for (unsigned long i = 0; i < MAX_LOOP; i++)
     a2a:	21 f7       	brne	.-56     	; 0x9f4 <__stack+0xf5>
    for (unsigned int j = 0; j < SIZE; j++) 
      if (arr[j] > 0)
        prod = mulFixed(prod, arr[j]);
  }

  productFixed = prod;
     a2c:	20 93 00 01 	sts	0x0100, r18	; 0x800100 <__data_start>
     a30:	30 93 01 01 	sts	0x0101, r19	; 0x800101 <__data_start+0x1>
     a34:	40 93 02 01 	sts	0x0102, r20	; 0x800102 <__data_start+0x2>
     a38:	50 93 03 01 	sts	0x0103, r21	; 0x800103 <__data_start+0x3>
}

unsigned long millis()
{
	unsigned long m;
	uint8_t oldSREG = SREG;
     a3c:	8f b7       	in	r24, 0x3f	; 63

	// disable interrupts while we read timer0_millis or we might get an
	// inconsistent value (e.g. in the middle of a write to timer0_millis)
	cli();
     a3e:	f8 94       	cli
	m = timer0_millis;
     a40:	c0 90 39 02 	lds	r12, 0x0239	; 0x800239 <timer0_millis>
     a44:	d0 90 3a 02 	lds	r13, 0x023A	; 0x80023a <timer0_millis+0x1>
     a48:	e0 90 3b 02 	lds	r14, 0x023B	; 0x80023b <timer0_millis+0x2>
     a4c:	f0 90 3c 02 	lds	r15, 0x023C	; 0x80023c <timer0_millis+0x3>
	SREG = oldSREG;
     a50:	8f bf       	out	0x3f, r24	; 63
     a52:	8b ea       	ldi	r24, 0xAB	; 171
     a54:	91 e0       	ldi	r25, 0x01	; 1
     a56:	0e 94 6c 01 	call	0x2d8	; 0x2d8 <_ZN5Print5writeEPKc.part.2.constprop.27>
  return (x * (1 << SCALE));
}

float fixedToFloat(int x)
{
  return (float)x / (float)(1 << SCALE);
     a5a:	60 91 00 01 	lds	r22, 0x0100	; 0x800100 <__data_start>
     a5e:	70 91 01 01 	lds	r23, 0x0101	; 0x800101 <__data_start+0x1>
     a62:	07 2e       	mov	r0, r23
     a64:	00 0c       	add	r0, r0
     a66:	88 0b       	sbc	r24, r24
     a68:	99 0b       	sbc	r25, r25
     a6a:	0e 94 ab 07 	call	0xf56	; 0xf56 <__floatsisf>
     a6e:	20 e0       	ldi	r18, 0x00	; 0
     a70:	30 e0       	ldi	r19, 0x00	; 0
     a72:	40 e8       	ldi	r20, 0x80	; 128
     a74:	5b e3       	ldi	r21, 0x3B	; 59
     a76:	0e 94 60 08 	call	0x10c0	; 0x10c0 <__mulsf3>
  multiplyFixed(listFixed);

  unsigned long stopTimeFixed = millis();  

  Serial.print("The product is: ");
  Serial.println(fixedToFloat(productFixed), 2);
     a7a:	0e 94 cb 01 	call	0x396	; 0x396 <_ZN5Print7printlnEdi.constprop.11>
  Serial.println("Time taken in ms: ");
     a7e:	8c eb       	ldi	r24, 0xBC	; 188
     a80:	91 e0       	ldi	r25, 0x01	; 1
     a82:	0e 94 bd 01 	call	0x37a	; 0x37a <_ZN5Print7printlnEPKc.constprop.18>
  Serial.println(stopTimeFixed - startTimeFixed);
     a86:	c7 01       	movw	r24, r14
     a88:	b6 01       	movw	r22, r12
     a8a:	68 19       	sub	r22, r8
     a8c:	79 09       	sbc	r23, r9
     a8e:	8a 09       	sbc	r24, r10
     a90:	9b 09       	sbc	r25, r11
}

size_t Print::print(unsigned long n, int base)
{
  if (base == 0) return write(n);
  else return printNumber(n, base);
     a92:	4a e0       	ldi	r20, 0x0A	; 10
     a94:	0e 94 79 01 	call	0x2f2	; 0x2f2 <_ZN5Print11printNumberEmh.constprop.24>
     a98:	8e e1       	ldi	r24, 0x1E	; 30
     a9a:	91 e0       	ldi	r25, 0x01	; 1
     a9c:	0e 94 6c 01 	call	0x2d8	; 0x2d8 <_ZN5Print5writeEPKc.part.2.constprop.27>
#endif

void serialEventRun(void)
{
#if defined(HAVE_HWSERIAL0)
  if (Serial0_available && serialEvent && Serial0_available()) serialEvent();
     aa0:	e0 e0       	ldi	r30, 0x00	; 0
     aa2:	f0 e0       	ldi	r31, 0x00	; 0
     aa4:	ef 2b       	or	r30, r31
     aa6:	e1 f3       	breq	.-8      	; 0xaa0 <__stack+0x1a1>
     aa8:	0e 94 c9 00 	call	0x192	; 0x192 <_Z17Serial0_availablev>
     aac:	88 23       	and	r24, r24
     aae:	c1 f3       	breq	.-16     	; 0xaa0 <__stack+0x1a1>
     ab0:	0e 94 00 00 	call	0	; 0x0 <__vectors>
     ab4:	f5 cf       	rjmp	.-22     	; 0xaa0 <__stack+0x1a1>

00000ab6 <_GLOBAL__sub_I___vector_18>:
    size_t printNumber(unsigned long, uint8_t);
    size_t printFloat(double, uint8_t);
  protected:
    void setWriteError(int err = 1) { write_error = err; }
  public:
    Print() : write_error(0) {}
     ab6:	eb e5       	ldi	r30, 0x5B	; 91
     ab8:	f2 e0       	ldi	r31, 0x02	; 2
     aba:	13 82       	std	Z+3, r1	; 0x03
     abc:	12 82       	std	Z+2, r1	; 0x02
  public:
    virtual int available() = 0;
    virtual int read() = 0;
    virtual int peek() = 0;

    Stream() {_timeout=1000;}
     abe:	88 ee       	ldi	r24, 0xE8	; 232
     ac0:	93 e0       	ldi	r25, 0x03	; 3
     ac2:	a0 e0       	ldi	r26, 0x00	; 0
     ac4:	b0 e0       	ldi	r27, 0x00	; 0
     ac6:	84 83       	std	Z+4, r24	; 0x04
     ac8:	95 83       	std	Z+5, r25	; 0x05
     aca:	a6 83       	std	Z+6, r26	; 0x06
     acc:	b7 83       	std	Z+7, r27	; 0x07
  volatile uint8_t *ucsrc, volatile uint8_t *udr) :
    _ubrrh(ubrrh), _ubrrl(ubrrl),
    _ucsra(ucsra), _ucsrb(ucsrb), _ucsrc(ucsrc),
    _udr(udr),
    _rx_buffer_head(0), _rx_buffer_tail(0),
    _tx_buffer_head(0), _tx_buffer_tail(0)
     ace:	80 e1       	ldi	r24, 0x10	; 16
     ad0:	91 e0       	ldi	r25, 0x01	; 1
     ad2:	91 83       	std	Z+1, r25	; 0x01
     ad4:	80 83       	st	Z, r24
     ad6:	85 ec       	ldi	r24, 0xC5	; 197
     ad8:	90 e0       	ldi	r25, 0x00	; 0
     ada:	95 87       	std	Z+13, r25	; 0x0d
     adc:	84 87       	std	Z+12, r24	; 0x0c
     ade:	84 ec       	ldi	r24, 0xC4	; 196
     ae0:	90 e0       	ldi	r25, 0x00	; 0
     ae2:	97 87       	std	Z+15, r25	; 0x0f
     ae4:	86 87       	std	Z+14, r24	; 0x0e
     ae6:	80 ec       	ldi	r24, 0xC0	; 192
     ae8:	90 e0       	ldi	r25, 0x00	; 0
     aea:	91 8b       	std	Z+17, r25	; 0x11
     aec:	80 8b       	std	Z+16, r24	; 0x10
     aee:	81 ec       	ldi	r24, 0xC1	; 193
     af0:	90 e0       	ldi	r25, 0x00	; 0
     af2:	93 8b       	std	Z+19, r25	; 0x13
     af4:	82 8b       	std	Z+18, r24	; 0x12
     af6:	82 ec       	ldi	r24, 0xC2	; 194
     af8:	90 e0       	ldi	r25, 0x00	; 0
     afa:	95 8b       	std	Z+21, r25	; 0x15
     afc:	84 8b       	std	Z+20, r24	; 0x14
     afe:	86 ec       	ldi	r24, 0xC6	; 198
     b00:	90 e0       	ldi	r25, 0x00	; 0
     b02:	97 8b       	std	Z+23, r25	; 0x17
     b04:	86 8b       	std	Z+22, r24	; 0x16
     b06:	11 8e       	std	Z+25, r1	; 0x19
     b08:	12 8e       	std	Z+26, r1	; 0x1a
     b0a:	13 8e       	std	Z+27, r1	; 0x1b
     b0c:	14 8e       	std	Z+28, r1	; 0x1c

// Function that can be weakly referenced by serialEventRun to prevent
// pulling in this file if it's not otherwise used.
bool Serial0_available() {
  return Serial.available();
}
     b0e:	08 95       	ret

00000b10 <random_r>:
     b10:	8f 92       	push	r8
     b12:	9f 92       	push	r9
     b14:	af 92       	push	r10
     b16:	bf 92       	push	r11
     b18:	cf 92       	push	r12
     b1a:	df 92       	push	r13
     b1c:	ef 92       	push	r14
     b1e:	ff 92       	push	r15
     b20:	cf 93       	push	r28
     b22:	df 93       	push	r29
     b24:	ec 01       	movw	r28, r24
     b26:	68 81       	ld	r22, Y
     b28:	79 81       	ldd	r23, Y+1	; 0x01
     b2a:	8a 81       	ldd	r24, Y+2	; 0x02
     b2c:	9b 81       	ldd	r25, Y+3	; 0x03
     b2e:	61 15       	cp	r22, r1
     b30:	71 05       	cpc	r23, r1
     b32:	81 05       	cpc	r24, r1
     b34:	91 05       	cpc	r25, r1
     b36:	21 f4       	brne	.+8      	; 0xb40 <random_r+0x30>
     b38:	64 e2       	ldi	r22, 0x24	; 36
     b3a:	79 ed       	ldi	r23, 0xD9	; 217
     b3c:	8b e5       	ldi	r24, 0x5B	; 91
     b3e:	97 e0       	ldi	r25, 0x07	; 7
     b40:	2d e1       	ldi	r18, 0x1D	; 29
     b42:	33 ef       	ldi	r19, 0xF3	; 243
     b44:	41 e0       	ldi	r20, 0x01	; 1
     b46:	50 e0       	ldi	r21, 0x00	; 0
     b48:	0e 94 2c 06 	call	0xc58	; 0xc58 <__divmodsi4>
     b4c:	49 01       	movw	r8, r18
     b4e:	5a 01       	movw	r10, r20
     b50:	9b 01       	movw	r18, r22
     b52:	ac 01       	movw	r20, r24
     b54:	a7 ea       	ldi	r26, 0xA7	; 167
     b56:	b1 e4       	ldi	r27, 0x41	; 65
     b58:	0e 94 4b 06 	call	0xc96	; 0xc96 <__muluhisi3>
     b5c:	6b 01       	movw	r12, r22
     b5e:	7c 01       	movw	r14, r24
     b60:	ac ee       	ldi	r26, 0xEC	; 236
     b62:	b4 ef       	ldi	r27, 0xF4	; 244
     b64:	a5 01       	movw	r20, r10
     b66:	94 01       	movw	r18, r8
     b68:	0e 94 59 06 	call	0xcb2	; 0xcb2 <__mulohisi3>
     b6c:	c6 0e       	add	r12, r22
     b6e:	d7 1e       	adc	r13, r23
     b70:	e8 1e       	adc	r14, r24
     b72:	f9 1e       	adc	r15, r25
     b74:	f7 fe       	sbrs	r15, 7
     b76:	06 c0       	rjmp	.+12     	; 0xb84 <random_r+0x74>
     b78:	81 e0       	ldi	r24, 0x01	; 1
     b7a:	c8 1a       	sub	r12, r24
     b7c:	d1 08       	sbc	r13, r1
     b7e:	e1 08       	sbc	r14, r1
     b80:	80 e8       	ldi	r24, 0x80	; 128
     b82:	f8 0a       	sbc	r15, r24
     b84:	c8 82       	st	Y, r12
     b86:	d9 82       	std	Y+1, r13	; 0x01
     b88:	ea 82       	std	Y+2, r14	; 0x02
     b8a:	fb 82       	std	Y+3, r15	; 0x03
     b8c:	c7 01       	movw	r24, r14
     b8e:	b6 01       	movw	r22, r12
     b90:	9f 77       	andi	r25, 0x7F	; 127
     b92:	df 91       	pop	r29
     b94:	cf 91       	pop	r28
     b96:	ff 90       	pop	r15
     b98:	ef 90       	pop	r14
     b9a:	df 90       	pop	r13
     b9c:	cf 90       	pop	r12
     b9e:	bf 90       	pop	r11
     ba0:	af 90       	pop	r10
     ba2:	9f 90       	pop	r9
     ba4:	8f 90       	pop	r8
     ba6:	08 95       	ret

00000ba8 <random>:
     ba8:	8f 92       	push	r8
     baa:	9f 92       	push	r9
     bac:	af 92       	push	r10
     bae:	bf 92       	push	r11
     bb0:	cf 92       	push	r12
     bb2:	df 92       	push	r13
     bb4:	ef 92       	push	r14
     bb6:	ff 92       	push	r15
     bb8:	60 91 08 01 	lds	r22, 0x0108	; 0x800108 <next>
     bbc:	70 91 09 01 	lds	r23, 0x0109	; 0x800109 <next+0x1>
     bc0:	80 91 0a 01 	lds	r24, 0x010A	; 0x80010a <next+0x2>
     bc4:	90 91 0b 01 	lds	r25, 0x010B	; 0x80010b <next+0x3>
     bc8:	61 15       	cp	r22, r1
     bca:	71 05       	cpc	r23, r1
     bcc:	81 05       	cpc	r24, r1
     bce:	91 05       	cpc	r25, r1
     bd0:	21 f4       	brne	.+8      	; 0xbda <random+0x32>
     bd2:	64 e2       	ldi	r22, 0x24	; 36
     bd4:	79 ed       	ldi	r23, 0xD9	; 217
     bd6:	8b e5       	ldi	r24, 0x5B	; 91
     bd8:	97 e0       	ldi	r25, 0x07	; 7
     bda:	2d e1       	ldi	r18, 0x1D	; 29
     bdc:	33 ef       	ldi	r19, 0xF3	; 243
     bde:	41 e0       	ldi	r20, 0x01	; 1
     be0:	50 e0       	ldi	r21, 0x00	; 0
     be2:	0e 94 2c 06 	call	0xc58	; 0xc58 <__divmodsi4>
     be6:	49 01       	movw	r8, r18
     be8:	5a 01       	movw	r10, r20
     bea:	9b 01       	movw	r18, r22
     bec:	ac 01       	movw	r20, r24
     bee:	a7 ea       	ldi	r26, 0xA7	; 167
     bf0:	b1 e4       	ldi	r27, 0x41	; 65
     bf2:	0e 94 4b 06 	call	0xc96	; 0xc96 <__muluhisi3>
     bf6:	6b 01       	movw	r12, r22
     bf8:	7c 01       	movw	r14, r24
     bfa:	ac ee       	ldi	r26, 0xEC	; 236
     bfc:	b4 ef       	ldi	r27, 0xF4	; 244
     bfe:	a5 01       	movw	r20, r10
     c00:	94 01       	movw	r18, r8
     c02:	0e 94 59 06 	call	0xcb2	; 0xcb2 <__mulohisi3>
     c06:	c6 0e       	add	r12, r22
     c08:	d7 1e       	adc	r13, r23
     c0a:	e8 1e       	adc	r14, r24
     c0c:	f9 1e       	adc	r15, r25
     c0e:	f7 fe       	sbrs	r15, 7
     c10:	06 c0       	rjmp	.+12     	; 0xc1e <random+0x76>
     c12:	81 e0       	ldi	r24, 0x01	; 1
     c14:	c8 1a       	sub	r12, r24
     c16:	d1 08       	sbc	r13, r1
     c18:	e1 08       	sbc	r14, r1
     c1a:	80 e8       	ldi	r24, 0x80	; 128
     c1c:	f8 0a       	sbc	r15, r24
     c1e:	c0 92 08 01 	sts	0x0108, r12	; 0x800108 <next>
     c22:	d0 92 09 01 	sts	0x0109, r13	; 0x800109 <next+0x1>
     c26:	e0 92 0a 01 	sts	0x010A, r14	; 0x80010a <next+0x2>
     c2a:	f0 92 0b 01 	sts	0x010B, r15	; 0x80010b <next+0x3>
     c2e:	c7 01       	movw	r24, r14
     c30:	b6 01       	movw	r22, r12
     c32:	9f 77       	andi	r25, 0x7F	; 127
     c34:	ff 90       	pop	r15
     c36:	ef 90       	pop	r14
     c38:	df 90       	pop	r13
     c3a:	cf 90       	pop	r12
     c3c:	bf 90       	pop	r11
     c3e:	af 90       	pop	r10
     c40:	9f 90       	pop	r9
     c42:	8f 90       	pop	r8
     c44:	08 95       	ret

00000c46 <srandom>:
     c46:	60 93 08 01 	sts	0x0108, r22	; 0x800108 <next>
     c4a:	70 93 09 01 	sts	0x0109, r23	; 0x800109 <next+0x1>
     c4e:	80 93 0a 01 	sts	0x010A, r24	; 0x80010a <next+0x2>
     c52:	90 93 0b 01 	sts	0x010B, r25	; 0x80010b <next+0x3>
     c56:	08 95       	ret

00000c58 <__divmodsi4>:
     c58:	05 2e       	mov	r0, r21
     c5a:	97 fb       	bst	r25, 7
     c5c:	1e f4       	brtc	.+6      	; 0xc64 <__divmodsi4+0xc>
     c5e:	00 94       	com	r0
     c60:	0e 94 43 06 	call	0xc86	; 0xc86 <__negsi2>
     c64:	57 fd       	sbrc	r21, 7
     c66:	07 d0       	rcall	.+14     	; 0xc76 <__divmodsi4_neg2>
     c68:	0e 94 5e 06 	call	0xcbc	; 0xcbc <__udivmodsi4>
     c6c:	07 fc       	sbrc	r0, 7
     c6e:	03 d0       	rcall	.+6      	; 0xc76 <__divmodsi4_neg2>
     c70:	4e f4       	brtc	.+18     	; 0xc84 <__divmodsi4_exit>
     c72:	0c 94 43 06 	jmp	0xc86	; 0xc86 <__negsi2>

00000c76 <__divmodsi4_neg2>:
     c76:	50 95       	com	r21
     c78:	40 95       	com	r20
     c7a:	30 95       	com	r19
     c7c:	21 95       	neg	r18
     c7e:	3f 4f       	sbci	r19, 0xFF	; 255
     c80:	4f 4f       	sbci	r20, 0xFF	; 255
     c82:	5f 4f       	sbci	r21, 0xFF	; 255

00000c84 <__divmodsi4_exit>:
     c84:	08 95       	ret

00000c86 <__negsi2>:
     c86:	90 95       	com	r25
     c88:	80 95       	com	r24
     c8a:	70 95       	com	r23
     c8c:	61 95       	neg	r22
     c8e:	7f 4f       	sbci	r23, 0xFF	; 255
     c90:	8f 4f       	sbci	r24, 0xFF	; 255
     c92:	9f 4f       	sbci	r25, 0xFF	; 255
     c94:	08 95       	ret

00000c96 <__muluhisi3>:
     c96:	0e 94 80 06 	call	0xd00	; 0xd00 <__umulhisi3>
     c9a:	a5 9f       	mul	r26, r21
     c9c:	90 0d       	add	r25, r0
     c9e:	b4 9f       	mul	r27, r20
     ca0:	90 0d       	add	r25, r0
     ca2:	a4 9f       	mul	r26, r20
     ca4:	80 0d       	add	r24, r0
     ca6:	91 1d       	adc	r25, r1
     ca8:	11 24       	eor	r1, r1
     caa:	08 95       	ret

00000cac <__mulshisi3>:
     cac:	b7 ff       	sbrs	r27, 7
     cae:	0c 94 4b 06 	jmp	0xc96	; 0xc96 <__muluhisi3>

00000cb2 <__mulohisi3>:
     cb2:	0e 94 4b 06 	call	0xc96	; 0xc96 <__muluhisi3>
     cb6:	82 1b       	sub	r24, r18
     cb8:	93 0b       	sbc	r25, r19
     cba:	08 95       	ret

00000cbc <__udivmodsi4>:
     cbc:	a1 e2       	ldi	r26, 0x21	; 33
     cbe:	1a 2e       	mov	r1, r26
     cc0:	aa 1b       	sub	r26, r26
     cc2:	bb 1b       	sub	r27, r27
     cc4:	fd 01       	movw	r30, r26
     cc6:	0d c0       	rjmp	.+26     	; 0xce2 <__udivmodsi4_ep>

00000cc8 <__udivmodsi4_loop>:
     cc8:	aa 1f       	adc	r26, r26
     cca:	bb 1f       	adc	r27, r27
     ccc:	ee 1f       	adc	r30, r30
     cce:	ff 1f       	adc	r31, r31
     cd0:	a2 17       	cp	r26, r18
     cd2:	b3 07       	cpc	r27, r19
     cd4:	e4 07       	cpc	r30, r20
     cd6:	f5 07       	cpc	r31, r21
     cd8:	20 f0       	brcs	.+8      	; 0xce2 <__udivmodsi4_ep>
     cda:	a2 1b       	sub	r26, r18
     cdc:	b3 0b       	sbc	r27, r19
     cde:	e4 0b       	sbc	r30, r20
     ce0:	f5 0b       	sbc	r31, r21

00000ce2 <__udivmodsi4_ep>:
     ce2:	66 1f       	adc	r22, r22
     ce4:	77 1f       	adc	r23, r23
     ce6:	88 1f       	adc	r24, r24
     ce8:	99 1f       	adc	r25, r25
     cea:	1a 94       	dec	r1
     cec:	69 f7       	brne	.-38     	; 0xcc8 <__udivmodsi4_loop>
     cee:	60 95       	com	r22
     cf0:	70 95       	com	r23
     cf2:	80 95       	com	r24
     cf4:	90 95       	com	r25
     cf6:	9b 01       	movw	r18, r22
     cf8:	ac 01       	movw	r20, r24
     cfa:	bd 01       	movw	r22, r26
     cfc:	cf 01       	movw	r24, r30
     cfe:	08 95       	ret

00000d00 <__umulhisi3>:
     d00:	a2 9f       	mul	r26, r18
     d02:	b0 01       	movw	r22, r0
     d04:	b3 9f       	mul	r27, r19
     d06:	c0 01       	movw	r24, r0
     d08:	a3 9f       	mul	r26, r19
     d0a:	70 0d       	add	r23, r0
     d0c:	81 1d       	adc	r24, r1
     d0e:	11 24       	eor	r1, r1
     d10:	91 1d       	adc	r25, r1
     d12:	b2 9f       	mul	r27, r18
     d14:	70 0d       	add	r23, r0
     d16:	81 1d       	adc	r24, r1
     d18:	11 24       	eor	r1, r1
     d1a:	91 1d       	adc	r25, r1
     d1c:	08 95       	ret

00000d1e <__subsf3>:
     d1e:	50 58       	subi	r21, 0x80	; 128

00000d20 <__addsf3>:
     d20:	bb 27       	eor	r27, r27
     d22:	aa 27       	eor	r26, r26
     d24:	0e 94 a7 06 	call	0xd4e	; 0xd4e <__addsf3x>
     d28:	0c 94 21 08 	jmp	0x1042	; 0x1042 <__fp_round>
     d2c:	0e 94 13 08 	call	0x1026	; 0x1026 <__fp_pscA>
     d30:	38 f0       	brcs	.+14     	; 0xd40 <__addsf3+0x20>
     d32:	0e 94 1a 08 	call	0x1034	; 0x1034 <__fp_pscB>
     d36:	20 f0       	brcs	.+8      	; 0xd40 <__addsf3+0x20>
     d38:	39 f4       	brne	.+14     	; 0xd48 <__addsf3+0x28>
     d3a:	9f 3f       	cpi	r25, 0xFF	; 255
     d3c:	19 f4       	brne	.+6      	; 0xd44 <__addsf3+0x24>
     d3e:	26 f4       	brtc	.+8      	; 0xd48 <__addsf3+0x28>
     d40:	0c 94 10 08 	jmp	0x1020	; 0x1020 <__fp_nan>
     d44:	0e f4       	brtc	.+2      	; 0xd48 <__addsf3+0x28>
     d46:	e0 95       	com	r30
     d48:	e7 fb       	bst	r30, 7
     d4a:	0c 94 0a 08 	jmp	0x1014	; 0x1014 <__fp_inf>

00000d4e <__addsf3x>:
     d4e:	e9 2f       	mov	r30, r25
     d50:	0e 94 32 08 	call	0x1064	; 0x1064 <__fp_split3>
     d54:	58 f3       	brcs	.-42     	; 0xd2c <__addsf3+0xc>
     d56:	ba 17       	cp	r27, r26
     d58:	62 07       	cpc	r22, r18
     d5a:	73 07       	cpc	r23, r19
     d5c:	84 07       	cpc	r24, r20
     d5e:	95 07       	cpc	r25, r21
     d60:	20 f0       	brcs	.+8      	; 0xd6a <__addsf3x+0x1c>
     d62:	79 f4       	brne	.+30     	; 0xd82 <__addsf3x+0x34>
     d64:	a6 f5       	brtc	.+104    	; 0xdce <__addsf3x+0x80>
     d66:	0c 94 54 08 	jmp	0x10a8	; 0x10a8 <__fp_zero>
     d6a:	0e f4       	brtc	.+2      	; 0xd6e <__addsf3x+0x20>
     d6c:	e0 95       	com	r30
     d6e:	0b 2e       	mov	r0, r27
     d70:	ba 2f       	mov	r27, r26
     d72:	a0 2d       	mov	r26, r0
     d74:	0b 01       	movw	r0, r22
     d76:	b9 01       	movw	r22, r18
     d78:	90 01       	movw	r18, r0
     d7a:	0c 01       	movw	r0, r24
     d7c:	ca 01       	movw	r24, r20
     d7e:	a0 01       	movw	r20, r0
     d80:	11 24       	eor	r1, r1
     d82:	ff 27       	eor	r31, r31
     d84:	59 1b       	sub	r21, r25
     d86:	99 f0       	breq	.+38     	; 0xdae <__addsf3x+0x60>
     d88:	59 3f       	cpi	r21, 0xF9	; 249
     d8a:	50 f4       	brcc	.+20     	; 0xda0 <__addsf3x+0x52>
     d8c:	50 3e       	cpi	r21, 0xE0	; 224
     d8e:	68 f1       	brcs	.+90     	; 0xdea <__addsf3x+0x9c>
     d90:	1a 16       	cp	r1, r26
     d92:	f0 40       	sbci	r31, 0x00	; 0
     d94:	a2 2f       	mov	r26, r18
     d96:	23 2f       	mov	r18, r19
     d98:	34 2f       	mov	r19, r20
     d9a:	44 27       	eor	r20, r20
     d9c:	58 5f       	subi	r21, 0xF8	; 248
     d9e:	f3 cf       	rjmp	.-26     	; 0xd86 <__addsf3x+0x38>
     da0:	46 95       	lsr	r20
     da2:	37 95       	ror	r19
     da4:	27 95       	ror	r18
     da6:	a7 95       	ror	r26
     da8:	f0 40       	sbci	r31, 0x00	; 0
     daa:	53 95       	inc	r21
     dac:	c9 f7       	brne	.-14     	; 0xda0 <__addsf3x+0x52>
     dae:	7e f4       	brtc	.+30     	; 0xdce <__addsf3x+0x80>
     db0:	1f 16       	cp	r1, r31
     db2:	ba 0b       	sbc	r27, r26
     db4:	62 0b       	sbc	r22, r18
     db6:	73 0b       	sbc	r23, r19
     db8:	84 0b       	sbc	r24, r20
     dba:	ba f0       	brmi	.+46     	; 0xdea <__addsf3x+0x9c>
     dbc:	91 50       	subi	r25, 0x01	; 1
     dbe:	a1 f0       	breq	.+40     	; 0xde8 <__addsf3x+0x9a>
     dc0:	ff 0f       	add	r31, r31
     dc2:	bb 1f       	adc	r27, r27
     dc4:	66 1f       	adc	r22, r22
     dc6:	77 1f       	adc	r23, r23
     dc8:	88 1f       	adc	r24, r24
     dca:	c2 f7       	brpl	.-16     	; 0xdbc <__addsf3x+0x6e>
     dcc:	0e c0       	rjmp	.+28     	; 0xdea <__addsf3x+0x9c>
     dce:	ba 0f       	add	r27, r26
     dd0:	62 1f       	adc	r22, r18
     dd2:	73 1f       	adc	r23, r19
     dd4:	84 1f       	adc	r24, r20
     dd6:	48 f4       	brcc	.+18     	; 0xdea <__addsf3x+0x9c>
     dd8:	87 95       	ror	r24
     dda:	77 95       	ror	r23
     ddc:	67 95       	ror	r22
     dde:	b7 95       	ror	r27
     de0:	f7 95       	ror	r31
     de2:	9e 3f       	cpi	r25, 0xFE	; 254
     de4:	08 f0       	brcs	.+2      	; 0xde8 <__addsf3x+0x9a>
     de6:	b0 cf       	rjmp	.-160    	; 0xd48 <__addsf3+0x28>
     de8:	93 95       	inc	r25
     dea:	88 0f       	add	r24, r24
     dec:	08 f0       	brcs	.+2      	; 0xdf0 <__addsf3x+0xa2>
     dee:	99 27       	eor	r25, r25
     df0:	ee 0f       	add	r30, r30
     df2:	97 95       	ror	r25
     df4:	87 95       	ror	r24
     df6:	08 95       	ret

00000df8 <__cmpsf2>:
     df8:	0e 94 e6 07 	call	0xfcc	; 0xfcc <__fp_cmp>
     dfc:	08 f4       	brcc	.+2      	; 0xe00 <__cmpsf2+0x8>
     dfe:	81 e0       	ldi	r24, 0x01	; 1
     e00:	08 95       	ret

00000e02 <__divsf3>:
     e02:	0e 94 15 07 	call	0xe2a	; 0xe2a <__divsf3x>
     e06:	0c 94 21 08 	jmp	0x1042	; 0x1042 <__fp_round>
     e0a:	0e 94 1a 08 	call	0x1034	; 0x1034 <__fp_pscB>
     e0e:	58 f0       	brcs	.+22     	; 0xe26 <__divsf3+0x24>
     e10:	0e 94 13 08 	call	0x1026	; 0x1026 <__fp_pscA>
     e14:	40 f0       	brcs	.+16     	; 0xe26 <__divsf3+0x24>
     e16:	29 f4       	brne	.+10     	; 0xe22 <__divsf3+0x20>
     e18:	5f 3f       	cpi	r21, 0xFF	; 255
     e1a:	29 f0       	breq	.+10     	; 0xe26 <__divsf3+0x24>
     e1c:	0c 94 0a 08 	jmp	0x1014	; 0x1014 <__fp_inf>
     e20:	51 11       	cpse	r21, r1
     e22:	0c 94 55 08 	jmp	0x10aa	; 0x10aa <__fp_szero>
     e26:	0c 94 10 08 	jmp	0x1020	; 0x1020 <__fp_nan>

00000e2a <__divsf3x>:
     e2a:	0e 94 32 08 	call	0x1064	; 0x1064 <__fp_split3>
     e2e:	68 f3       	brcs	.-38     	; 0xe0a <__divsf3+0x8>

00000e30 <__divsf3_pse>:
     e30:	99 23       	and	r25, r25
     e32:	b1 f3       	breq	.-20     	; 0xe20 <__divsf3+0x1e>
     e34:	55 23       	and	r21, r21
     e36:	91 f3       	breq	.-28     	; 0xe1c <__divsf3+0x1a>
     e38:	95 1b       	sub	r25, r21
     e3a:	55 0b       	sbc	r21, r21
     e3c:	bb 27       	eor	r27, r27
     e3e:	aa 27       	eor	r26, r26
     e40:	62 17       	cp	r22, r18
     e42:	73 07       	cpc	r23, r19
     e44:	84 07       	cpc	r24, r20
     e46:	38 f0       	brcs	.+14     	; 0xe56 <__divsf3_pse+0x26>
     e48:	9f 5f       	subi	r25, 0xFF	; 255
     e4a:	5f 4f       	sbci	r21, 0xFF	; 255
     e4c:	22 0f       	add	r18, r18
     e4e:	33 1f       	adc	r19, r19
     e50:	44 1f       	adc	r20, r20
     e52:	aa 1f       	adc	r26, r26
     e54:	a9 f3       	breq	.-22     	; 0xe40 <__divsf3_pse+0x10>
     e56:	35 d0       	rcall	.+106    	; 0xec2 <__divsf3_pse+0x92>
     e58:	0e 2e       	mov	r0, r30
     e5a:	3a f0       	brmi	.+14     	; 0xe6a <__divsf3_pse+0x3a>
     e5c:	e0 e8       	ldi	r30, 0x80	; 128
     e5e:	32 d0       	rcall	.+100    	; 0xec4 <__divsf3_pse+0x94>
     e60:	91 50       	subi	r25, 0x01	; 1
     e62:	50 40       	sbci	r21, 0x00	; 0
     e64:	e6 95       	lsr	r30
     e66:	00 1c       	adc	r0, r0
     e68:	ca f7       	brpl	.-14     	; 0xe5c <__divsf3_pse+0x2c>
     e6a:	2b d0       	rcall	.+86     	; 0xec2 <__divsf3_pse+0x92>
     e6c:	fe 2f       	mov	r31, r30
     e6e:	29 d0       	rcall	.+82     	; 0xec2 <__divsf3_pse+0x92>
     e70:	66 0f       	add	r22, r22
     e72:	77 1f       	adc	r23, r23
     e74:	88 1f       	adc	r24, r24
     e76:	bb 1f       	adc	r27, r27
     e78:	26 17       	cp	r18, r22
     e7a:	37 07       	cpc	r19, r23
     e7c:	48 07       	cpc	r20, r24
     e7e:	ab 07       	cpc	r26, r27
     e80:	b0 e8       	ldi	r27, 0x80	; 128
     e82:	09 f0       	breq	.+2      	; 0xe86 <__divsf3_pse+0x56>
     e84:	bb 0b       	sbc	r27, r27
     e86:	80 2d       	mov	r24, r0
     e88:	bf 01       	movw	r22, r30
     e8a:	ff 27       	eor	r31, r31
     e8c:	93 58       	subi	r25, 0x83	; 131
     e8e:	5f 4f       	sbci	r21, 0xFF	; 255
     e90:	3a f0       	brmi	.+14     	; 0xea0 <__divsf3_pse+0x70>
     e92:	9e 3f       	cpi	r25, 0xFE	; 254
     e94:	51 05       	cpc	r21, r1
     e96:	78 f0       	brcs	.+30     	; 0xeb6 <__divsf3_pse+0x86>
     e98:	0c 94 0a 08 	jmp	0x1014	; 0x1014 <__fp_inf>
     e9c:	0c 94 55 08 	jmp	0x10aa	; 0x10aa <__fp_szero>
     ea0:	5f 3f       	cpi	r21, 0xFF	; 255
     ea2:	e4 f3       	brlt	.-8      	; 0xe9c <__divsf3_pse+0x6c>
     ea4:	98 3e       	cpi	r25, 0xE8	; 232
     ea6:	d4 f3       	brlt	.-12     	; 0xe9c <__divsf3_pse+0x6c>
     ea8:	86 95       	lsr	r24
     eaa:	77 95       	ror	r23
     eac:	67 95       	ror	r22
     eae:	b7 95       	ror	r27
     eb0:	f7 95       	ror	r31
     eb2:	9f 5f       	subi	r25, 0xFF	; 255
     eb4:	c9 f7       	brne	.-14     	; 0xea8 <__divsf3_pse+0x78>
     eb6:	88 0f       	add	r24, r24
     eb8:	91 1d       	adc	r25, r1
     eba:	96 95       	lsr	r25
     ebc:	87 95       	ror	r24
     ebe:	97 f9       	bld	r25, 7
     ec0:	08 95       	ret
     ec2:	e1 e0       	ldi	r30, 0x01	; 1
     ec4:	66 0f       	add	r22, r22
     ec6:	77 1f       	adc	r23, r23
     ec8:	88 1f       	adc	r24, r24
     eca:	bb 1f       	adc	r27, r27
     ecc:	62 17       	cp	r22, r18
     ece:	73 07       	cpc	r23, r19
     ed0:	84 07       	cpc	r24, r20
     ed2:	ba 07       	cpc	r27, r26
     ed4:	20 f0       	brcs	.+8      	; 0xede <__divsf3_pse+0xae>
     ed6:	62 1b       	sub	r22, r18
     ed8:	73 0b       	sbc	r23, r19
     eda:	84 0b       	sbc	r24, r20
     edc:	ba 0b       	sbc	r27, r26
     ede:	ee 1f       	adc	r30, r30
     ee0:	88 f7       	brcc	.-30     	; 0xec4 <__divsf3_pse+0x94>
     ee2:	e0 95       	com	r30
     ee4:	08 95       	ret

00000ee6 <__fixsfsi>:
     ee6:	0e 94 7a 07 	call	0xef4	; 0xef4 <__fixunssfsi>
     eea:	68 94       	set
     eec:	b1 11       	cpse	r27, r1
     eee:	0c 94 55 08 	jmp	0x10aa	; 0x10aa <__fp_szero>
     ef2:	08 95       	ret

00000ef4 <__fixunssfsi>:
     ef4:	0e 94 3a 08 	call	0x1074	; 0x1074 <__fp_splitA>
     ef8:	88 f0       	brcs	.+34     	; 0xf1c <__fixunssfsi+0x28>
     efa:	9f 57       	subi	r25, 0x7F	; 127
     efc:	98 f0       	brcs	.+38     	; 0xf24 <__fixunssfsi+0x30>
     efe:	b9 2f       	mov	r27, r25
     f00:	99 27       	eor	r25, r25
     f02:	b7 51       	subi	r27, 0x17	; 23
     f04:	b0 f0       	brcs	.+44     	; 0xf32 <__fixunssfsi+0x3e>
     f06:	e1 f0       	breq	.+56     	; 0xf40 <__fixunssfsi+0x4c>
     f08:	66 0f       	add	r22, r22
     f0a:	77 1f       	adc	r23, r23
     f0c:	88 1f       	adc	r24, r24
     f0e:	99 1f       	adc	r25, r25
     f10:	1a f0       	brmi	.+6      	; 0xf18 <__fixunssfsi+0x24>
     f12:	ba 95       	dec	r27
     f14:	c9 f7       	brne	.-14     	; 0xf08 <__fixunssfsi+0x14>
     f16:	14 c0       	rjmp	.+40     	; 0xf40 <__fixunssfsi+0x4c>
     f18:	b1 30       	cpi	r27, 0x01	; 1
     f1a:	91 f0       	breq	.+36     	; 0xf40 <__fixunssfsi+0x4c>
     f1c:	0e 94 54 08 	call	0x10a8	; 0x10a8 <__fp_zero>
     f20:	b1 e0       	ldi	r27, 0x01	; 1
     f22:	08 95       	ret
     f24:	0c 94 54 08 	jmp	0x10a8	; 0x10a8 <__fp_zero>
     f28:	67 2f       	mov	r22, r23
     f2a:	78 2f       	mov	r23, r24
     f2c:	88 27       	eor	r24, r24
     f2e:	b8 5f       	subi	r27, 0xF8	; 248
     f30:	39 f0       	breq	.+14     	; 0xf40 <__fixunssfsi+0x4c>
     f32:	b9 3f       	cpi	r27, 0xF9	; 249
     f34:	cc f3       	brlt	.-14     	; 0xf28 <__fixunssfsi+0x34>
     f36:	86 95       	lsr	r24
     f38:	77 95       	ror	r23
     f3a:	67 95       	ror	r22
     f3c:	b3 95       	inc	r27
     f3e:	d9 f7       	brne	.-10     	; 0xf36 <__fixunssfsi+0x42>
     f40:	3e f4       	brtc	.+14     	; 0xf50 <__fixunssfsi+0x5c>
     f42:	90 95       	com	r25
     f44:	80 95       	com	r24
     f46:	70 95       	com	r23
     f48:	61 95       	neg	r22
     f4a:	7f 4f       	sbci	r23, 0xFF	; 255
     f4c:	8f 4f       	sbci	r24, 0xFF	; 255
     f4e:	9f 4f       	sbci	r25, 0xFF	; 255
     f50:	08 95       	ret

00000f52 <__floatunsisf>:
     f52:	e8 94       	clt
     f54:	09 c0       	rjmp	.+18     	; 0xf68 <__floatsisf+0x12>

00000f56 <__floatsisf>:
     f56:	97 fb       	bst	r25, 7
     f58:	3e f4       	brtc	.+14     	; 0xf68 <__floatsisf+0x12>
     f5a:	90 95       	com	r25
     f5c:	80 95       	com	r24
     f5e:	70 95       	com	r23
     f60:	61 95       	neg	r22
     f62:	7f 4f       	sbci	r23, 0xFF	; 255
     f64:	8f 4f       	sbci	r24, 0xFF	; 255
     f66:	9f 4f       	sbci	r25, 0xFF	; 255
     f68:	99 23       	and	r25, r25
     f6a:	a9 f0       	breq	.+42     	; 0xf96 <__floatsisf+0x40>
     f6c:	f9 2f       	mov	r31, r25
     f6e:	96 e9       	ldi	r25, 0x96	; 150
     f70:	bb 27       	eor	r27, r27
     f72:	93 95       	inc	r25
     f74:	f6 95       	lsr	r31
     f76:	87 95       	ror	r24
     f78:	77 95       	ror	r23
     f7a:	67 95       	ror	r22
     f7c:	b7 95       	ror	r27
     f7e:	f1 11       	cpse	r31, r1
     f80:	f8 cf       	rjmp	.-16     	; 0xf72 <__floatsisf+0x1c>
     f82:	fa f4       	brpl	.+62     	; 0xfc2 <__floatsisf+0x6c>
     f84:	bb 0f       	add	r27, r27
     f86:	11 f4       	brne	.+4      	; 0xf8c <__floatsisf+0x36>
     f88:	60 ff       	sbrs	r22, 0
     f8a:	1b c0       	rjmp	.+54     	; 0xfc2 <__floatsisf+0x6c>
     f8c:	6f 5f       	subi	r22, 0xFF	; 255
     f8e:	7f 4f       	sbci	r23, 0xFF	; 255
     f90:	8f 4f       	sbci	r24, 0xFF	; 255
     f92:	9f 4f       	sbci	r25, 0xFF	; 255
     f94:	16 c0       	rjmp	.+44     	; 0xfc2 <__floatsisf+0x6c>
     f96:	88 23       	and	r24, r24
     f98:	11 f0       	breq	.+4      	; 0xf9e <__floatsisf+0x48>
     f9a:	96 e9       	ldi	r25, 0x96	; 150
     f9c:	11 c0       	rjmp	.+34     	; 0xfc0 <__floatsisf+0x6a>
     f9e:	77 23       	and	r23, r23
     fa0:	21 f0       	breq	.+8      	; 0xfaa <__floatsisf+0x54>
     fa2:	9e e8       	ldi	r25, 0x8E	; 142
     fa4:	87 2f       	mov	r24, r23
     fa6:	76 2f       	mov	r23, r22
     fa8:	05 c0       	rjmp	.+10     	; 0xfb4 <__floatsisf+0x5e>
     faa:	66 23       	and	r22, r22
     fac:	71 f0       	breq	.+28     	; 0xfca <__floatsisf+0x74>
     fae:	96 e8       	ldi	r25, 0x86	; 134
     fb0:	86 2f       	mov	r24, r22
     fb2:	70 e0       	ldi	r23, 0x00	; 0
     fb4:	60 e0       	ldi	r22, 0x00	; 0
     fb6:	2a f0       	brmi	.+10     	; 0xfc2 <__floatsisf+0x6c>
     fb8:	9a 95       	dec	r25
     fba:	66 0f       	add	r22, r22
     fbc:	77 1f       	adc	r23, r23
     fbe:	88 1f       	adc	r24, r24
     fc0:	da f7       	brpl	.-10     	; 0xfb8 <__floatsisf+0x62>
     fc2:	88 0f       	add	r24, r24
     fc4:	96 95       	lsr	r25
     fc6:	87 95       	ror	r24
     fc8:	97 f9       	bld	r25, 7
     fca:	08 95       	ret

00000fcc <__fp_cmp>:
     fcc:	99 0f       	add	r25, r25
     fce:	00 08       	sbc	r0, r0
     fd0:	55 0f       	add	r21, r21
     fd2:	aa 0b       	sbc	r26, r26
     fd4:	e0 e8       	ldi	r30, 0x80	; 128
     fd6:	fe ef       	ldi	r31, 0xFE	; 254
     fd8:	16 16       	cp	r1, r22
     fda:	17 06       	cpc	r1, r23
     fdc:	e8 07       	cpc	r30, r24
     fde:	f9 07       	cpc	r31, r25
     fe0:	c0 f0       	brcs	.+48     	; 0x1012 <__fp_cmp+0x46>
     fe2:	12 16       	cp	r1, r18
     fe4:	13 06       	cpc	r1, r19
     fe6:	e4 07       	cpc	r30, r20
     fe8:	f5 07       	cpc	r31, r21
     fea:	98 f0       	brcs	.+38     	; 0x1012 <__fp_cmp+0x46>
     fec:	62 1b       	sub	r22, r18
     fee:	73 0b       	sbc	r23, r19
     ff0:	84 0b       	sbc	r24, r20
     ff2:	95 0b       	sbc	r25, r21
     ff4:	39 f4       	brne	.+14     	; 0x1004 <__fp_cmp+0x38>
     ff6:	0a 26       	eor	r0, r26
     ff8:	61 f0       	breq	.+24     	; 0x1012 <__fp_cmp+0x46>
     ffa:	23 2b       	or	r18, r19
     ffc:	24 2b       	or	r18, r20
     ffe:	25 2b       	or	r18, r21
    1000:	21 f4       	brne	.+8      	; 0x100a <__fp_cmp+0x3e>
    1002:	08 95       	ret
    1004:	0a 26       	eor	r0, r26
    1006:	09 f4       	brne	.+2      	; 0x100a <__fp_cmp+0x3e>
    1008:	a1 40       	sbci	r26, 0x01	; 1
    100a:	a6 95       	lsr	r26
    100c:	8f ef       	ldi	r24, 0xFF	; 255
    100e:	81 1d       	adc	r24, r1
    1010:	81 1d       	adc	r24, r1
    1012:	08 95       	ret

00001014 <__fp_inf>:
    1014:	97 f9       	bld	r25, 7
    1016:	9f 67       	ori	r25, 0x7F	; 127
    1018:	80 e8       	ldi	r24, 0x80	; 128
    101a:	70 e0       	ldi	r23, 0x00	; 0
    101c:	60 e0       	ldi	r22, 0x00	; 0
    101e:	08 95       	ret

00001020 <__fp_nan>:
    1020:	9f ef       	ldi	r25, 0xFF	; 255
    1022:	80 ec       	ldi	r24, 0xC0	; 192
    1024:	08 95       	ret

00001026 <__fp_pscA>:
    1026:	00 24       	eor	r0, r0
    1028:	0a 94       	dec	r0
    102a:	16 16       	cp	r1, r22
    102c:	17 06       	cpc	r1, r23
    102e:	18 06       	cpc	r1, r24
    1030:	09 06       	cpc	r0, r25
    1032:	08 95       	ret

00001034 <__fp_pscB>:
    1034:	00 24       	eor	r0, r0
    1036:	0a 94       	dec	r0
    1038:	12 16       	cp	r1, r18
    103a:	13 06       	cpc	r1, r19
    103c:	14 06       	cpc	r1, r20
    103e:	05 06       	cpc	r0, r21
    1040:	08 95       	ret

00001042 <__fp_round>:
    1042:	09 2e       	mov	r0, r25
    1044:	03 94       	inc	r0
    1046:	00 0c       	add	r0, r0
    1048:	11 f4       	brne	.+4      	; 0x104e <__fp_round+0xc>
    104a:	88 23       	and	r24, r24
    104c:	52 f0       	brmi	.+20     	; 0x1062 <__fp_round+0x20>
    104e:	bb 0f       	add	r27, r27
    1050:	40 f4       	brcc	.+16     	; 0x1062 <__fp_round+0x20>
    1052:	bf 2b       	or	r27, r31
    1054:	11 f4       	brne	.+4      	; 0x105a <__fp_round+0x18>
    1056:	60 ff       	sbrs	r22, 0
    1058:	04 c0       	rjmp	.+8      	; 0x1062 <__fp_round+0x20>
    105a:	6f 5f       	subi	r22, 0xFF	; 255
    105c:	7f 4f       	sbci	r23, 0xFF	; 255
    105e:	8f 4f       	sbci	r24, 0xFF	; 255
    1060:	9f 4f       	sbci	r25, 0xFF	; 255
    1062:	08 95       	ret

00001064 <__fp_split3>:
    1064:	57 fd       	sbrc	r21, 7
    1066:	90 58       	subi	r25, 0x80	; 128
    1068:	44 0f       	add	r20, r20
    106a:	55 1f       	adc	r21, r21
    106c:	59 f0       	breq	.+22     	; 0x1084 <__fp_splitA+0x10>
    106e:	5f 3f       	cpi	r21, 0xFF	; 255
    1070:	71 f0       	breq	.+28     	; 0x108e <__fp_splitA+0x1a>
    1072:	47 95       	ror	r20

00001074 <__fp_splitA>:
    1074:	88 0f       	add	r24, r24
    1076:	97 fb       	bst	r25, 7
    1078:	99 1f       	adc	r25, r25
    107a:	61 f0       	breq	.+24     	; 0x1094 <__fp_splitA+0x20>
    107c:	9f 3f       	cpi	r25, 0xFF	; 255
    107e:	79 f0       	breq	.+30     	; 0x109e <__fp_splitA+0x2a>
    1080:	87 95       	ror	r24
    1082:	08 95       	ret
    1084:	12 16       	cp	r1, r18
    1086:	13 06       	cpc	r1, r19
    1088:	14 06       	cpc	r1, r20
    108a:	55 1f       	adc	r21, r21
    108c:	f2 cf       	rjmp	.-28     	; 0x1072 <__fp_split3+0xe>
    108e:	46 95       	lsr	r20
    1090:	f1 df       	rcall	.-30     	; 0x1074 <__fp_splitA>
    1092:	08 c0       	rjmp	.+16     	; 0x10a4 <__fp_splitA+0x30>
    1094:	16 16       	cp	r1, r22
    1096:	17 06       	cpc	r1, r23
    1098:	18 06       	cpc	r1, r24
    109a:	99 1f       	adc	r25, r25
    109c:	f1 cf       	rjmp	.-30     	; 0x1080 <__fp_splitA+0xc>
    109e:	86 95       	lsr	r24
    10a0:	71 05       	cpc	r23, r1
    10a2:	61 05       	cpc	r22, r1
    10a4:	08 94       	sec
    10a6:	08 95       	ret

000010a8 <__fp_zero>:
    10a8:	e8 94       	clt

000010aa <__fp_szero>:
    10aa:	bb 27       	eor	r27, r27
    10ac:	66 27       	eor	r22, r22
    10ae:	77 27       	eor	r23, r23
    10b0:	cb 01       	movw	r24, r22
    10b2:	97 f9       	bld	r25, 7
    10b4:	08 95       	ret

000010b6 <__gesf2>:
    10b6:	0e 94 e6 07 	call	0xfcc	; 0xfcc <__fp_cmp>
    10ba:	08 f4       	brcc	.+2      	; 0x10be <__gesf2+0x8>
    10bc:	8f ef       	ldi	r24, 0xFF	; 255
    10be:	08 95       	ret

000010c0 <__mulsf3>:
    10c0:	0e 94 73 08 	call	0x10e6	; 0x10e6 <__mulsf3x>
    10c4:	0c 94 21 08 	jmp	0x1042	; 0x1042 <__fp_round>
    10c8:	0e 94 13 08 	call	0x1026	; 0x1026 <__fp_pscA>
    10cc:	38 f0       	brcs	.+14     	; 0x10dc <__mulsf3+0x1c>
    10ce:	0e 94 1a 08 	call	0x1034	; 0x1034 <__fp_pscB>
    10d2:	20 f0       	brcs	.+8      	; 0x10dc <__mulsf3+0x1c>
    10d4:	95 23       	and	r25, r21
    10d6:	11 f0       	breq	.+4      	; 0x10dc <__mulsf3+0x1c>
    10d8:	0c 94 0a 08 	jmp	0x1014	; 0x1014 <__fp_inf>
    10dc:	0c 94 10 08 	jmp	0x1020	; 0x1020 <__fp_nan>
    10e0:	11 24       	eor	r1, r1
    10e2:	0c 94 55 08 	jmp	0x10aa	; 0x10aa <__fp_szero>

000010e6 <__mulsf3x>:
    10e6:	0e 94 32 08 	call	0x1064	; 0x1064 <__fp_split3>
    10ea:	70 f3       	brcs	.-36     	; 0x10c8 <__mulsf3+0x8>

000010ec <__mulsf3_pse>:
    10ec:	95 9f       	mul	r25, r21
    10ee:	c1 f3       	breq	.-16     	; 0x10e0 <__mulsf3+0x20>
    10f0:	95 0f       	add	r25, r21
    10f2:	50 e0       	ldi	r21, 0x00	; 0
    10f4:	55 1f       	adc	r21, r21
    10f6:	62 9f       	mul	r22, r18
    10f8:	f0 01       	movw	r30, r0
    10fa:	72 9f       	mul	r23, r18
    10fc:	bb 27       	eor	r27, r27
    10fe:	f0 0d       	add	r31, r0
    1100:	b1 1d       	adc	r27, r1
    1102:	63 9f       	mul	r22, r19
    1104:	aa 27       	eor	r26, r26
    1106:	f0 0d       	add	r31, r0
    1108:	b1 1d       	adc	r27, r1
    110a:	aa 1f       	adc	r26, r26
    110c:	64 9f       	mul	r22, r20
    110e:	66 27       	eor	r22, r22
    1110:	b0 0d       	add	r27, r0
    1112:	a1 1d       	adc	r26, r1
    1114:	66 1f       	adc	r22, r22
    1116:	82 9f       	mul	r24, r18
    1118:	22 27       	eor	r18, r18
    111a:	b0 0d       	add	r27, r0
    111c:	a1 1d       	adc	r26, r1
    111e:	62 1f       	adc	r22, r18
    1120:	73 9f       	mul	r23, r19
    1122:	b0 0d       	add	r27, r0
    1124:	a1 1d       	adc	r26, r1
    1126:	62 1f       	adc	r22, r18
    1128:	83 9f       	mul	r24, r19
    112a:	a0 0d       	add	r26, r0
    112c:	61 1d       	adc	r22, r1
    112e:	22 1f       	adc	r18, r18
    1130:	74 9f       	mul	r23, r20
    1132:	33 27       	eor	r19, r19
    1134:	a0 0d       	add	r26, r0
    1136:	61 1d       	adc	r22, r1
    1138:	23 1f       	adc	r18, r19
    113a:	84 9f       	mul	r24, r20
    113c:	60 0d       	add	r22, r0
    113e:	21 1d       	adc	r18, r1
    1140:	82 2f       	mov	r24, r18
    1142:	76 2f       	mov	r23, r22
    1144:	6a 2f       	mov	r22, r26
    1146:	11 24       	eor	r1, r1
    1148:	9f 57       	subi	r25, 0x7F	; 127
    114a:	50 40       	sbci	r21, 0x00	; 0
    114c:	9a f0       	brmi	.+38     	; 0x1174 <__mulsf3_pse+0x88>
    114e:	f1 f0       	breq	.+60     	; 0x118c <__mulsf3_pse+0xa0>
    1150:	88 23       	and	r24, r24
    1152:	4a f0       	brmi	.+18     	; 0x1166 <__mulsf3_pse+0x7a>
    1154:	ee 0f       	add	r30, r30
    1156:	ff 1f       	adc	r31, r31
    1158:	bb 1f       	adc	r27, r27
    115a:	66 1f       	adc	r22, r22
    115c:	77 1f       	adc	r23, r23
    115e:	88 1f       	adc	r24, r24
    1160:	91 50       	subi	r25, 0x01	; 1
    1162:	50 40       	sbci	r21, 0x00	; 0
    1164:	a9 f7       	brne	.-22     	; 0x1150 <__mulsf3_pse+0x64>
    1166:	9e 3f       	cpi	r25, 0xFE	; 254
    1168:	51 05       	cpc	r21, r1
    116a:	80 f0       	brcs	.+32     	; 0x118c <__mulsf3_pse+0xa0>
    116c:	0c 94 0a 08 	jmp	0x1014	; 0x1014 <__fp_inf>
    1170:	0c 94 55 08 	jmp	0x10aa	; 0x10aa <__fp_szero>
    1174:	5f 3f       	cpi	r21, 0xFF	; 255
    1176:	e4 f3       	brlt	.-8      	; 0x1170 <__mulsf3_pse+0x84>
    1178:	98 3e       	cpi	r25, 0xE8	; 232
    117a:	d4 f3       	brlt	.-12     	; 0x1170 <__mulsf3_pse+0x84>
    117c:	86 95       	lsr	r24
    117e:	77 95       	ror	r23
    1180:	67 95       	ror	r22
    1182:	b7 95       	ror	r27
    1184:	f7 95       	ror	r31
    1186:	e7 95       	ror	r30
    1188:	9f 5f       	subi	r25, 0xFF	; 255
    118a:	c1 f7       	brne	.-16     	; 0x117c <__mulsf3_pse+0x90>
    118c:	fe 2b       	or	r31, r30
    118e:	88 0f       	add	r24, r24
    1190:	91 1d       	adc	r25, r1
    1192:	96 95       	lsr	r25
    1194:	87 95       	ror	r24
    1196:	97 f9       	bld	r25, 7
    1198:	08 95       	ret

0000119a <__unordsf2>:
    119a:	0e 94 e6 07 	call	0xfcc	; 0xfcc <__fp_cmp>
    119e:	88 0b       	sbc	r24, r24
    11a0:	99 0b       	sbc	r25, r25
    11a2:	08 95       	ret

000011a4 <__tablejump2__>:
    11a4:	ee 0f       	add	r30, r30
    11a6:	ff 1f       	adc	r31, r31
    11a8:	05 90       	lpm	r0, Z+
    11aa:	f4 91       	lpm	r31, Z
    11ac:	e0 2d       	mov	r30, r0
    11ae:	09 94       	ijmp

000011b0 <_exit>:
    11b0:	f8 94       	cli

000011b2 <__stop_program>:
    11b2:	ff cf       	rjmp	.-2      	; 0x11b2 <__stop_program>
